/* generated by ASAP2 Studio 2.6.12.11813 */ ASAP2_VERSION 1 71
/begin PROJECT ProjectName "This a2l file contains all the generic measurement and calibration objects that are relevant for a project based on Speed 4.0 platform"
/begin MODULE ModuleName ""
/begin MOD_PAR "" /end MOD_PAR
/begin MOD_COMMON "" BYTE_ORDER MSB_LAST ALIGNMENT_BYTE 1 ALIGNMENT_WORD 2 ALIGNMENT_LONG 4 ALIGNMENT_FLOAT16_IEEE 2 ALIGNMENT_FLOAT32_IEEE 4 ALIGNMENT_FLOAT64_IEEE 8 ALIGNMENT_INT64 8 /end MOD_COMMON
/begin IF_DATA XCP
 /begin PROTOCOL_LAYER 0x0100 0x07D0 0x2710 0x00 0x00 0x00 0x00 0x00 0x08 0x08 BYTE_ORDER_MSB_LAST ADDRESS_GRANULARITY_BYTE OPTIONAL_CMD ALLOC_ODT_ENTRY OPTIONAL_CMD ALLOC_ODT OPTIONAL_CMD ALLOC_DAQ OPTIONAL_CMD FREE_DAQ OPTIONAL_CMD GET_DAQ_EVENT_INFO OPTIONAL_CMD GET_DAQ_RESOLUTION_INFO OPTIONAL_CMD GET_DAQ_PROCESSOR_INFO OPTIONAL_CMD START_STOP_SYNCH OPTIONAL_CMD START_STOP_DAQ_LIST OPTIONAL_CMD GET_DAQ_LIST_MODE OPTIONAL_CMD SET_DAQ_LIST_MODE OPTIONAL_CMD WRITE_DAQ OPTIONAL_CMD SET_DAQ_PTR OPTIONAL_CMD CLEAR_DAQ_LIST OPTIONAL_CMD DOWNLOAD OPTIONAL_CMD USER_CMD OPTIONAL_CMD SHORT_UPLOAD OPTIONAL_CMD UPLOAD OPTIONAL_CMD SET_MTA OPTIONAL_CMD UNLOCK OPTIONAL_CMD GET_SEED OPTIONAL_CMD SET_REQUEST OPTIONAL_CMD GET_COMM_MODE_INFO COMMUNICATION_MODE_SUPPORTED BLOCK SLAVE MASTER 0x2B 0xC8 /end PROTOCOL_LAYER
 /begin DAQ DYNAMIC 0x00 0x04 0x00 OPTIMISATION_TYPE_DEFAULT ADDRESS_EXTENSION_FREE IDENTIFICATION_FIELD_TYPE_ABSOLUTE GRANULARITY_ODT_ENTRY_SIZE_DAQ_BYTE 0x07 NO_OVERLOAD_INDICATION
  /begin STIM GRANULARITY_ODT_ENTRY_SIZE_STIM_BYTE 0x01 BIT_STIM_SUPPORTED /end STIM
  /begin EVENT "BSW_1ms" "BSW_1ms" 0x00 DAQ_STIM 0x01 0x01 0x06 0x00 /end EVENT
  /begin EVENT "BSW_10ms" "BSW_10ms" 0x01 DAQ_STIM 0x01 0x0A 0x06 0x00 /end EVENT
  /begin EVENT "BSW_20ms" "BSW_20ms" 0x02 DAQ_STIM 0x01 0x14 0x06 0x00 /end EVENT
  /begin EVENT "BSW_100ms" "BSW_100ms" 0x03 DAQ_STIM 0x01 0x64 0x06 0x00 /end EVENT
 /end DAQ
 /begin PAG 0x00 /end PAG
 /begin PGM PGM_MODE_ABSOLUTE 0x00 0x00 /end PGM
 /begin XCP_ON_CAN 0x0100 CAN_ID_MASTER 0x07F1 CAN_ID_SLAVE 0x07F2 BAUDRATE 0x07A120 SAMPLE_POINT 0x4B SAMPLE_RATE SINGLE BTL_CYCLES 0x08 SJW 0x02 SYNC_EDGE SINGLE MAX_DLC_REQUIRED /end XCP_ON_CAN
/end IF_DATA
/begin CHARACTERISTIC CD_Calibration "" VALUE 0x700002D8 __SByte_Value 0 CRASH_DETECTION_CALIB_Copy1 -128 127 /end CHARACTERISTIC
/begin MEASUREMENT CarState "" SBYTE CAR_STATE_T 0 0 -128 127 ECU_ADDRESS 0x700002E8 SYMBOL_LINK "CarData.carState" 0 /end MEASUREMENT
/begin MEASUREMENT CrashState "" SBYTE CRASH_STATE_T_Copy1 0 0 -128 127 ECU_ADDRESS 0x700002EA SYMBOL_LINK "CarData.crashState" 0 /end MEASUREMENT
/begin MEASUREMENT FlipState "" SBYTE CAR_STATE_T 0 0 -128 127 ECU_ADDRESS 0x700002E9 SYMBOL_LINK "CarData.carFlipInfo" 0 /end MEASUREMENT
/begin MEASUREMENT _STT_PH_e_Phase "" SBYTE _STT_PH_e_Phase.CONVERSION 0 0 0 255 ECU_ADDRESS 0x700213DD FORMAT "%.15" SYMBOL_LINK "STTStartupPhases_e_Phase" 0 /end MEASUREMENT
/begin MEASUREMENT adc_xVal "" FLOAT32_IEEE NO_COMPU_METHOD 0 0 -3.40282346639E+38 3.40282346639E+38 ECU_ADDRESS 0x7000021C SYMBOL_LINK "ADC_Results.xAxisValue" 0 /end MEASUREMENT
/begin MEASUREMENT adc_yVal "" FLOAT32_IEEE NO_COMPU_METHOD 0 0 -3.40282346639E+38 3.40282346639E+38 ECU_ADDRESS 0x70000220 SYMBOL_LINK "ADC_Results.yAxisValue" 0 /end MEASUREMENT
/begin MEASUREMENT adc_zVal "" FLOAT32_IEEE NO_COMPU_METHOD 0 0 -3.40282346639E+38 3.40282346639E+38 ECU_ADDRESS 0x70000224 SYMBOL_LINK "ADC_Results.zAxisValue" 0 /end MEASUREMENT
/begin MEASUREMENT counter10ms "" UBYTE NO_COMPU_METHOD 0 0 0 255 ECU_ADDRESS 0x700001A0
 /begin IF_DATA XCP
  /begin DAQ_EVENT FIXED_EVENT_LIST EVENT 0x04 /end DAQ_EVENT
 /end IF_DATA
/end MEASUREMENT
/begin MEASUREMENT g_results "" UBYTE NO_COMPU_METHOD 0 0 0 255 ECU_ADDRESS 0x70000250
 /begin IF_DATA XCP
  /begin DAQ_EVENT FIXED_EVENT_LIST EVENT 0x04 /end DAQ_EVENT
 /end IF_DATA
/end MEASUREMENT
/begin MEASUREMENT x_AxisG "" FLOAT32_IEEE NO_COMPU_METHOD 0 0 -3.40282346639E+38 3.40282346639E+38 ECU_ADDRESS 0x70000004
 /begin IF_DATA XCP
  /begin DAQ_EVENT FIXED_EVENT_LIST EVENT 0x04 /end DAQ_EVENT
 /end IF_DATA
/end MEASUREMENT
/begin MEASUREMENT x_AxisResult "" UWORD NO_COMPU_METHOD 0 0 0 65535 ECU_ADDRESS 0x70000250 SYMBOL_LINK "g_results._0_.B.RESULT" 0
 /begin IF_DATA XCP
  /begin DAQ_EVENT FIXED_EVENT_LIST EVENT 0x04 /end DAQ_EVENT
 /end IF_DATA
/end MEASUREMENT
/begin MEASUREMENT y_AxisG "" FLOAT32_IEEE NO_COMPU_METHOD 0 0 -3.40282346639E+38 3.40282346639E+38 ECU_ADDRESS 0x7000000C
 /begin IF_DATA XCP
  /begin DAQ_EVENT FIXED_EVENT_LIST EVENT 0x04 /end DAQ_EVENT
 /end IF_DATA
/end MEASUREMENT
/begin MEASUREMENT y_AxisResult "" UWORD NO_COMPU_METHOD 0 0 0 65535 ECU_ADDRESS 0x70000254 SYMBOL_LINK "g_results._1_.B.RESULT" 0
 /begin IF_DATA XCP
  /begin DAQ_EVENT FIXED_EVENT_LIST EVENT 0x04 /end DAQ_EVENT
 /end IF_DATA
/end MEASUREMENT
/begin MEASUREMENT z_AxisG "" FLOAT32_IEEE NO_COMPU_METHOD 0 0 -3.40282346639E+38 3.40282346639E+38 ECU_ADDRESS 0x70000014
 /begin IF_DATA XCP
  /begin DAQ_EVENT FIXED_EVENT_LIST EVENT 0x04 /end DAQ_EVENT
 /end IF_DATA
/end MEASUREMENT
/begin MEASUREMENT z_AxisResult "" UWORD NO_COMPU_METHOD 0 0 0 65535 ECU_ADDRESS 0x70000258 SYMBOL_LINK "g_results._2_.B.RESULT" 0
 /begin IF_DATA XCP
  /begin DAQ_EVENT FIXED_EVENT_LIST EVENT 0x04 /end DAQ_EVENT
 /end IF_DATA
/end MEASUREMENT
/begin COMPU_METHOD CAR_STATE_T "" TAB_VERB "%.0" "" COMPU_TAB_REF CAR_STATE_T /end COMPU_METHOD
/begin COMPU_METHOD COMBO_ISC_Redundant_VariantType.CONVERSION "@@@@RuleName created by CANape" LINEAR "%3.1" "" COEFFS_LINEAR 0.001953152 0 /end COMPU_METHOD
/begin COMPU_METHOD COMBO_PITCH_VariantType.CONVERSION "@@@@RuleName created by CANape" LINEAR "%3.1" "" COEFFS_LINEAR 0.001953152 0 /end COMPU_METHOD
/begin COMPU_METHOD CRASH_DETECTION_CALIB "" TAB_VERB "%.0" "" COMPU_TAB_REF CRASH_DETECTION_CALIB /end COMPU_METHOD
/begin COMPU_METHOD CRASH_DETECTION_CALIB_Copy1 "enumeration table" TAB_VERB "%.0" "" COMPU_TAB_REF CRASH_DETECTION_CALIB_Copy1 /end COMPU_METHOD
/begin COMPU_METHOD CRASH_STATE_T "" TAB_VERB "%.0" "" COMPU_TAB_REF CRASH_STATE_T /end COMPU_METHOD
/begin COMPU_METHOD CRASH_STATE_T_Copy1 "enumeration table" TAB_VERB "%.0" "" COMPU_TAB_REF CRASH_STATE_T_Copy1 /end COMPU_METHOD
/begin COMPU_METHOD EXC1_DloopOutput_Resistance.CONVERSION "@@@@RuleName created by CANape" LINEAR "%3.1" "" COEFFS_LINEAR 0.001 0 /end COMPU_METHOD
/begin COMPU_METHOD EXC1_DloopOutput_SrcLowCurrent.CONVERSION "@@@@RuleName created by CANape" LINEAR "%3.1" "" COEFFS_LINEAR 0.01543 0 /end COMPU_METHOD
/begin COMPU_METHOD EXC1_DloopOutput_SrmHighCurrent.CONVERSION "@@@@RuleName created by CANape" LINEAR "%3.1" "" COEFFS_LINEAR 0.00488 0 /end COMPU_METHOD
/begin COMPU_METHOD EXC1_DloopOutput_SrmLowCurrent.CONVERSION "@@@@RuleName created by CANape" LINEAR "%3.1" "" COEFFS_LINEAR 0.00488 0 /end COMPU_METHOD
/begin COMPU_METHOD EXC1_ReferenceOutputSrmHighCurrent.CONVERSION "@@@@RuleName created by CANape" LINEAR "%3.1" "" COEFFS_LINEAR 0.00488 0 /end COMPU_METHOD
/begin COMPU_METHOD EXC1_ReferenceOutput_SrcLowCurrent.CONVERSION "@@@@RuleName created by CANape" LINEAR "%3.1" "" COEFFS_LINEAR 0.01543 0 /end COMPU_METHOD
/begin COMPU_METHOD EXC1_ReferenceOutput_SrmLowCurrent.CONVERSION "@@@@RuleName created by CANape" LINEAR "%3.1" "" COEFFS_LINEAR 0.00488 0 /end COMPU_METHOD
/begin COMPU_METHOD EXC1_VzOutput.CONVERSION "@@@@RuleName created by CANape" LINEAR "%3.1" "" COEFFS_LINEAR 0.04394 0 /end COMPU_METHOD
/begin COMPU_METHOD EXC2_DloopOutput_Resistance.CONVERSION "@@@@RuleName created by CANape" LINEAR "%3.1" "" COEFFS_LINEAR 0.001 0 /end COMPU_METHOD
/begin COMPU_METHOD EXC2_DloopOutput_SrcLowCurrent.CONVERSION "@@@@RuleName created by CANape" LINEAR "%3.1" "" COEFFS_LINEAR 0.01543 0 /end COMPU_METHOD
/begin COMPU_METHOD EXC2_DloopOutput_SrmHighCurrent.CONVERSION "@@@@RuleName created by CANape" LINEAR "%3.1" "" COEFFS_LINEAR 0.00488 0 /end COMPU_METHOD
/begin COMPU_METHOD EXC2_DloopOutput_SrmLowCurrent.CONVERSION "@@@@RuleName created by CANape" LINEAR "%3.1" "" COEFFS_LINEAR 0.00488 0 /end COMPU_METHOD
/begin COMPU_METHOD EXC2_ReferenceOutputSrmHighCurrent.CONVERSION "@@@@RuleName created by CANape" LINEAR "%3.1" "" COEFFS_LINEAR 0.00488 0 /end COMPU_METHOD
/begin COMPU_METHOD EXC2_ReferenceOutput_SrcLowCurrent.CONVERSION "@@@@RuleName created by CANape" LINEAR "%3.1" "" COEFFS_LINEAR 0.01543 0 /end COMPU_METHOD
/begin COMPU_METHOD EXC2_ReferenceOutput_SrmLowCurrent.CONVERSION "@@@@RuleName created by CANape" LINEAR "%3.1" "" COEFFS_LINEAR 0.00488 0 /end COMPU_METHOD
/begin COMPU_METHOD EXC2_VzOutput.CONVERSION "@@@@RuleName created by CANape" LINEAR "%3.1" "" COEFFS_LINEAR 0.04394 0 /end COMPU_METHOD
/begin COMPU_METHOD E_ASICSEnergyR_VZ_C_Deploy_Low "enumeration table" TAB_VERB "%.0" "" COMPU_TAB_REF E_ASICSEnergyR_VZ_C_Deploy_Low /end COMPU_METHOD
/begin COMPU_METHOD E_ASICS_EXT_SUP_STATE "enumeration table" TAB_VERB "%.0" "" COMPU_TAB_REF E_ASICS_EXT_SUP_STATE /end COMPU_METHOD
/begin COMPU_METHOD E_ASICS_OP_EVZ "enumeration table" TAB_VERB "%.0" "" COMPU_TAB_REF E_ASICS_OP_EVZ /end COMPU_METHOD
/begin COMPU_METHOD E_ASICS_OP_SUP "enumeration table" TAB_VERB "%.0" "" COMPU_TAB_REF E_ASICS_OP_SUP /end COMPU_METHOD
/begin COMPU_METHOD E_ASICS_OP_VZ "enumeration table" TAB_VERB "%.0" "" COMPU_TAB_REF E_ASICS_OP_VZ /end COMPU_METHOD
/begin COMPU_METHOD E_HAL_Result "enumeration table" TAB_VERB "%.0" "" COMPU_TAB_REF E_HAL_Result /end COMPU_METHOD
/begin COMPU_METHOD E_HAL_Result.OLD_Copy1 "decoder for bit states" TAB_VERB "%3.1" "" COMPU_TAB_REF E_HAL_Result.OLD_1 /end COMPU_METHOD
/begin COMPU_METHOD E_HAL_Result_Copy1 "enumeration table" TAB_VERB "%.0" "" COMPU_TAB_REF E_HAL_Result_Copy1 /end COMPU_METHOD
/begin COMPU_METHOD E_PCB_LOB_STATUS "enumeration table" TAB_VERB "%.0" "" COMPU_TAB_REF E_PCB_LOB_STATUS /end COMPU_METHOD
/begin COMPU_METHOD E_SWITCHDev_STATE "enumeration table" TAB_VERB "%.0" "" COMPU_TAB_REF E_SWITCHDev_STATE /end COMPU_METHOD
/begin COMPU_METHOD E_SWITCHType_MEAS_STATE "enumeration table" TAB_VERB "%.0" "" COMPU_TAB_REF E_SWITCHType_MEAS_STATE /end COMPU_METHOD
/begin COMPU_METHOD FAULT_CODES "Interpretation of the fault codes" TAB_VERB "%3.1" "" COMPU_TAB_REF FAULT_CODES_S1 /end COMPU_METHOD
/begin COMPU_METHOD FAULT_STATUS "Decoding of the status of the fault" TAB_VERB "%3.1" "" COMPU_TAB_REF FAULT_STATUS /end COMPU_METHOD
/begin COMPU_METHOD INFORMATION_CODES "decoding rule for information codes" TAB_VERB "%3.1" "" COMPU_TAB_REF INFORMATION_CODES_S1 /end COMPU_METHOD
/begin COMPU_METHOD LIFE_TIMER.CONVERSION "@@@@RuleName created by CANape" IDENTICAL "%3.1" "" /end COMPU_METHOD
/begin COMPU_METHOD OCA_e_ShutdownStepQm.CONVERSION "@@@@RuleName created by CANape" TAB_VERB "%.0" "" COMPU_TAB_REF OCA_e_ShutdownStepQm.CONVERSION /end COMPU_METHOD
/begin COMPU_METHOD PM_caub_RomSwVers[0].CONVERSION "@@@@RuleName created by CANape" TAB_VERB "%.0" "" COMPU_TAB_REF OCA_e_ShutdownStepQm.CONVERSION /end COMPU_METHOD
/begin COMPU_METHOD PM_caub_RomSwVers[1].CONVERSION "@@@@RuleName created by CANape" TAB_VERB "%.0" "" COMPU_TAB_REF OCA_e_ShutdownStepQm.CONVERSION /end COMPU_METHOD
/begin COMPU_METHOD PM_caub_RomSwVers[2].CONVERSION "@@@@RuleName created by CANape" TAB_VERB "%.0" "" COMPU_TAB_REF OCA_e_ShutdownStepQm.CONVERSION /end COMPU_METHOD
/begin COMPU_METHOD PM_caub_RomSwVers[3].CONVERSION "@@@@RuleName created by CANape" TAB_VERB "%.0" "" COMPU_TAB_REF OCA_e_ShutdownStepQm.CONVERSION /end COMPU_METHOD
/begin COMPU_METHOD PM_caub_RomSwVers[4].CONVERSION "@@@@RuleName created by CANape" TAB_VERB "%.0" "" COMPU_TAB_REF OCA_e_ShutdownStepQm.CONVERSION /end COMPU_METHOD
/begin COMPU_METHOD SATLine_as_LineInfo._9_.e_StateTask.CONVERSION "enumeration table" TAB_VERB "%.0" "" COMPU_TAB_REF SATLine_as_LineInfo._9_.e_StateTask.CONVERSION /end COMPU_METHOD
/begin COMPU_METHOD SATSen_as_Sensor._9_.e_SenState.CONVERSION "enumeration table" TAB_VERB "%.0" "" COMPU_TAB_REF SATSen_as_Sensor._9_.e_SenState.CONVERSION /end COMPU_METHOD
/begin COMPU_METHOD SAT_1_STATE.CONVERSION "enumeration table" TAB_VERB "%.0" "" COMPU_TAB_REF SAT_1_STATE.CONVERSION /end COMPU_METHOD
/begin COMPU_METHOD SAT_1_STATE.CONVERSION.OLD_Copy1 "enumeration table" TAB_VERB "%.0" "" COMPU_TAB_REF SAT_1_STATE.CONVERSION.OLD_1 /end COMPU_METHOD
/begin COMPU_METHOD SAT_LINE_STATE "Decoder for the sat line states" TAB_VERB "%3.1" "" COMPU_TAB_REF SAT_LINE_STATE /end COMPU_METHOD
/begin COMPU_METHOD SAT_Line_1_State.CONVERSION "enumeration table" TAB_VERB "%.0" "" COMPU_TAB_REF SAT_Line_1_State.CONVERSION /end COMPU_METHOD
/begin COMPU_METHOD SEN_STATE "enumeration table" TAB_VERB "%.0" "" COMPU_TAB_REF SEN_STATE /end COMPU_METHOD
/begin COMPU_METHOD SQUIB_LEAKAGE_FLAG "decoder of the reference squib leakage to battery flag" TAB_VERB "%3.1" "" COMPU_TAB_REF REF_SQUIB_LEAKAGE /end COMPU_METHOD
/begin COMPU_METHOD SUPPLY_VOLTAGE.CONVERSION "@@@@RuleName created by CANape" LINEAR "%3.1" "" COEFFS_LINEAR 0.01 0 /end COMPU_METHOD
/begin COMPU_METHOD SWIHIF_REF_MEAS_STATUS "" TAB_VERB "%3.1" "" COMPU_TAB_REF SWIHIF_REF_MEAS_STATUS /end COMPU_METHOD
/begin COMPU_METHOD SWIHIF_STATUS "Status of SWIHIF interface after a measurement" TAB_VERB "%3.1" "" COMPU_TAB_REF SWIHIF_STATUS /end COMPU_METHOD
/begin COMPU_METHOD SWIHIF_TYPE "Types of switches measured by SWIHIF" TAB_VERB "%3.1" "" COMPU_TAB_REF SWIHIF_TYPES /end COMPU_METHOD
/begin COMPU_METHOD SWITCH_STATE "Decoder for the switch states" TAB_VERB "%3.1" "" COMPU_TAB_REF SWITCH_STATE /end COMPU_METHOD
/begin COMPU_METHOD SWITCH_STATE_CROSSLINK "Decoder for the switch crosslink states" TAB_VERB "%3.1" "" COMPU_TAB_REF SWITCH_STATE_CROSSLINK /end COMPU_METHOD
/begin COMPU_METHOD SYC_DloopOutput_Resistance.CONVERSION "@@@@RuleName created by CANape" LINEAR "%3.1" "" COEFFS_LINEAR 0.001 0 /end COMPU_METHOD
/begin COMPU_METHOD SYC_DloopOutput_SrcLowCurrent.CONVERSION "@@@@RuleName created by CANape" LINEAR "%3.1" "" COEFFS_LINEAR 0.01543 0 /end COMPU_METHOD
/begin COMPU_METHOD SYC_DloopOutput_SrmHighCurrent.CONVERSION "@@@@RuleName created by CANape" LINEAR "%3.1" "" COEFFS_LINEAR 0.00488 0 /end COMPU_METHOD
/begin COMPU_METHOD SYC_DloopOutput_SrmLowCurrent.CONVERSION "@@@@RuleName created by CANape" LINEAR "%3.1" "" COEFFS_LINEAR 0.00488 0 /end COMPU_METHOD
/begin COMPU_METHOD SYC_ReferenceOutputSrmHighCurrent.CONVERSION "@@@@RuleName created by CANape" LINEAR "%3.1" "" COEFFS_LINEAR 0.00488 0 /end COMPU_METHOD
/begin COMPU_METHOD SYC_ReferenceOutput_SrcLowCurrent.CONVERSION "@@@@RuleName created by CANape" LINEAR "%3.1" "" COEFFS_LINEAR 0.01543 0 /end COMPU_METHOD
/begin COMPU_METHOD SYC_ReferenceOutput_SrmLowCurrent.CONVERSION "@@@@RuleName created by CANape" LINEAR "%3.1" "" COEFFS_LINEAR 0.00488 0 /end COMPU_METHOD
/begin COMPU_METHOD SYC_VzOutput.CONVERSION "@@@@RuleName created by CANape" LINEAR "%3.1" "" COEFFS_LINEAR 0.04394 0 /end COMPU_METHOD
/begin COMPU_METHOD SquibRegValue "" FORM "%3.1" "" /begin FORMULA "X>>4" /end FORMULA /end COMPU_METHOD
/begin COMPU_METHOD YES_NO "decoder for bit states" TAB_VERB "%3.1" "" COMPU_TAB_REF YES_NO /end COMPU_METHOD
/begin COMPU_METHOD _STT_PH_e_Phase.CONVERSION "@@@@RuleName created by CANape" TAB_VERB "%.0" "" COMPU_TAB_REF _STT_PH_e_Phase.CONVERSION /end COMPU_METHOD
/begin COMPU_VTAB CAR_STATE_T "" TAB_VERB 6 0 "CAR_STATE_ERROR" 1 "CAR_STATE_NORMAL" 2 "CAR_STATE_UPSIDE_DOWN" 3 "CAR_STATE_FLIPPED_RIGHT" 4 "CAR_STATE_FLIPPED_LEFT" 5 "CAR_STATE_CRASHED" /end COMPU_VTAB
/begin COMPU_VTAB CRASH_DETECTION_CALIB "" TAB_VERB 3 0 "CRASH_DETECTION_NO_ACTION" 1 "CRASH_DETECTION_RESET" 2 "CRASH_DETECTION_CHANGE_AXIS" /end COMPU_VTAB
/begin COMPU_VTAB CRASH_DETECTION_CALIB_Copy1 "enumeration table" TAB_VERB 2 0 "CRASH_DETECTION_NO_ACTION" 1 "CRASH_DETECTION_RESET" /end COMPU_VTAB
/begin COMPU_VTAB CRASH_STATE_T "" TAB_VERB 6 0 "CRASH_STATE_ERROR" 1 "NO_CRASH" 2 "BACKSIDE_CRASH" 3 "FRONTSIDE_CRASH" 4 "LEFTSIDE_CRASH" 5 "RIGHTSIDE_CRASH" /end COMPU_VTAB
/begin COMPU_VTAB CRASH_STATE_T_Copy1 "enumeration table" TAB_VERB 6 0 "CRASH_STATE_ERROR" 1 "CRASH_STATE_NO_CRASH" 2 "CRASH_STATE_BACKSIDE_CRASH" 3 "CRASH_STATE_FRONTSIDE_CRASH" 4 "CRASH_STATE_LEFTSIDE_CRASH" 5 "CRASH_STATE_RIGHTSIDE_CRASH" /end COMPU_VTAB
/begin COMPU_VTAB_RANGE DMV_CODES "Table to define the ranges of the DMV codes" 22 50 50 "MC_t_SYC_REF_SQUIB" 51 51 "MC_t_EXC1_REF_SQUIB" 52 52 "MC_t_EXC2_REF_SQUIB" 53 53 "MC_t_SAFING_TR_DIAG" 54 54 "MC_t_2ND_SAFING_TR_DIAG" 80 95 "MC_t_BASE_SYC_POLARITY_SQ" 100 115 "MC_t_BASE_SYC_DIAG_SQ" 116 127 "MC_t_BASE_EXC1_DIAG_SQ" 128 139 "MC_t_BASE_EXC2_DIAG_SQ" 140 155 "MC_t_BASE_SYC_HSLS_SQ" 156 167 "MC_t_BASE_EXC1_HSLS_SQ" 168 179 "MC_t_BASE_EXC2_HSLS_SQ" 180 188 "MC_t_BASE_SYC_VZ" 190 195 "MC_t_BASE_EXC1_VZ" 196 201 "MC_t_BASE_EXC2_VZ" 300 311 "MC_t_BASE_SWIHIF_DIAG" 350 361 "MC_t_BASE_SWITCH" 400 403 "MC_t_SYC_LD_STATUS" 405 405 "MC_t_EXC1_LD_STATUS" 406 406 "MC_t_EXC2_LD_STATUS" 415 415 "MC_t_SQ_CROSSLINK" 416 416 "MC_t_BASE_SWIHIF_REF_DIAG" DEFAULT_VALUE "" /end COMPU_VTAB_RANGE
/begin COMPU_VTAB_RANGE E_ASICSEnergyR_VZ_C_Deploy_Low "" 2 0 0 "ASICSEnergyR_e_Inactive" 1 1 "ASICSEnergyR_e_Active" DEFAULT_VALUE "" /end COMPU_VTAB_RANGE
/begin COMPU_VTAB_RANGE E_ASICS_EXT_SUP_STATE "" 3 0 0 "ASICS_e_EXT_HI" 1 1 "ASICS_e_EXT_NR" 2 2 "ASICS_e_EXT_LOW" DEFAULT_VALUE "" /end COMPU_VTAB_RANGE
/begin COMPU_VTAB_RANGE E_ASICS_OP_EVZ "" 4 0 0 "ASICS_e_OP_EVZ_ATK" 1 1 "ASICS_e_OP_EVZ_B" 2 2 "ASICS_e_OP_EVZ_A" 3 3 "ASICS_e_OP_EVZ_HI" DEFAULT_VALUE "" /end COMPU_VTAB_RANGE
/begin COMPU_VTAB_RANGE E_ASICS_OP_SUP "" 5 0 0 "ASICS_e_OP_SUP_HI" 1 1 "ASICS_e_OP_SUP_A" 2 2 "ASICS_e_OP_SUP_B" 3 3 "ASICS_e_OP_SUP_C" 4 4 "ASICS_e_OP_SUP_OFF" DEFAULT_VALUE "" /end COMPU_VTAB_RANGE
/begin COMPU_VTAB_RANGE E_ASICS_OP_VZ "" 3 0 0 "ASICS_e_OP_VZ_A" 1 1 "ASICS_e_OP_VZ_B" 2 2 "ASICS_e_OP_VZ_C" DEFAULT_VALUE "" /end COMPU_VTAB_RANGE
/begin COMPU_VTAB_RANGE E_HAL_Result "" 3 0 0 "HAL_e_OK" 1 1 "HAL_e_NOK" 2 2 "HAL_e_NOT_PERFORMED" DEFAULT_VALUE "" /end COMPU_VTAB_RANGE
/begin COMPU_VTAB_RANGE E_HAL_Result.OLD_1 "Measurement result" 3 0 0 "OK" 1 1 "NOT_OK" 2 2 "NOT_PERFORMED" DEFAULT_VALUE "" /end COMPU_VTAB_RANGE
/begin COMPU_VTAB E_HAL_Result_Copy1 "enumeration table" TAB_VERB 3 0 "HAL_e_OK" 1 "HAL_e_NOK" 2 "HAL_e_NOT_PERFORMED" DEFAULT_VALUE "" /end COMPU_VTAB
/begin COMPU_VTAB_RANGE E_PCB_LOB_STATUS "" 2 0 0 "PCB_e_LOB_ACTIVE" 1 1 "PCB_e_LOB_INACTIVE" DEFAULT_VALUE "" /end COMPU_VTAB_RANGE
/begin COMPU_VTAB_RANGE E_SWITCHDev_STATE "" 3 0 0 "E_SWITCHDev_STATE_DIAG_CONFIGURED" 1 1 "E_SWITCHDev_STATE_DIAG_UNCONFIGURED" 2 2 "E_SWITCHDev_STATE_DIAG_OFF" DEFAULT_VALUE "" /end COMPU_VTAB_RANGE
/begin COMPU_VTAB_RANGE E_SWITCHType_MEAS_STATE "" 3 0 0 "E_SWITCHType_MEAS_STATE_DIAG_HAL" 1 1 "E_SWITCHType_MEAS_STATE_DIAG_OFF" 2 2 "E_SWITCHType_MEAS_STATE_DIAG_COM" DEFAULT_VALUE "" /end COMPU_VTAB_RANGE
/begin COMPU_VTAB FAULT_CODES_S1 "Interpretation of the fault codes" TAB_VERB 678 0 "_VEH_SPEED_CRCERROR" 0 "_ECM_ABSENT" 0 "_VDC_ABSENT" 0 "_METER_ABSENT" 0 "_BCM_ABSENT" 0 "_IDM_ABSENT" 0 "_USM_ABSENT" 0 "_HEVC_ABSENT" 0 "_ATCU_ABSENT" 0 "_ADAS_ABSENT" 0 "_EPKB_ABSENT" 0 "_EBA_ABSENT" 0 "_IVI_ABSENT" 0 "_IVC_ABSENT" 0 "_ARMQ_SAT_FAULT" 0 "_IASG_CROSSLINK_DETECTED" 1 "_SENSOR_CONFIG_ERROR" 2 "_DIGITAL_SENSOR1_INIT_FAULT" 3 "_DIGITAL_SENSOR1_CHANNEL0_TEST_FAULT" 4 "_DIGITAL_SENSOR1_CHANNEL1_TEST_FAULT" 5 "_DIGITAL_SENSOR1_COMM_FAULT" 6 "_DIGITAL_SENSOR1_CLOCK_COUNTER_FAULT" 7 "_DIGITAL_SENSOR1_PERMANANT_DEFECT" 8 "_DIGITAL_SENSOR2_INIT_FAULT" 9 "_DIGITAL_SENSOR2_CHANNEL0_TEST_FAULT" 10 "_DIGITAL_SENSOR2_CHANNEL1_TEST_FAULT" 11 "_DIGITAL_SENSOR2_COMM_FAULT" 12 "_DIGITAL_SENSOR2_CLOCK_COUNTER_FAULT" 13 "_DIGITAL_SENSOR2_PERMANANT_DEFECT" 14 "_CAN_BUSOFF" 15 "_CRC_FAIL_CO_CALIBRATION" 16 "_REF_SQ_FAULT_SYC" 17 "_REF_SQ_FAULT_EXC_1" 18 "_REF_SQ_FAULT_EXC_2" 19 "_CONFIG_SQUIB_CURRENT_TIME_SYC" 20 "_CONFIG_SQUIB_CURRENT_TIME_EXC1" 21 "_CONFIG_SQUIB_CURRENT_TIME_EXC2" 22 "_SQ_CONFIG_MISMATCH" 23 "_CRC_FAIL_SQUIB_LIMITS" 24 "_CRC_FAIL_DEPLOY_CONFIG" 25 "_CRC_FAIL_SQUIB_CONFIG" 26 "_BD1_INVALID_CONF" 27 "_BDFP_INVALID_CONF" 28 "_BFD_INVALID_CONF" 29 "_BFP_INVALID_CONF" 30 "_BLD_INVALID_CONF" 31 "_BLP_INVALID_CONF" 32 "_BP2D_INVALID_CONF" 33 "_BP2P_INVALID_CONF" 34 "_BRD_INVALID_CONF" 35 "_BRP_INVALID_CONF" 36 "_CUL_INVALID_CONF" 37 "_CUR_INVALID_CONF" 38 "_FAD_INVALID_CONF" 39 "_FAD2_INVALID_CONF" 40 "_FAP_INVALID_CONF" 41 "_FAP2_INVALID_CONF" 42 "_HVB1_INVALID_CONF" 43 "_HVB2_INVALID_CONF" 44 "_KAD_INVALID_CONF" 45 "_KAP_INVALID_CONF" 46 "_PPBD_INVALID_CONF" 47 "_PPBP_INVALID_CONF" 48 "_RBL_INVALID_CONF" 49 "_RBR_INVALID_CONF" 50 "_SA2L_INVALID_CONF" 51 "_SA2R_INVALID_CONF" 52 "_SAD_INVALID_CONF" 53 "_SAP_INVALID_CONF" 54 "_BD1_CROSSLINK" 55 "_BDFP_CROSSLINK" 56 "_BFD_CROSSLINK" 57 "_BFP_CROSSLINK" 58 "_BLD_CROSSLINK" 59 "_BLP_CROSSLINK" 60 "_BP2D_CROSSLINK" 61 "_BP2P_CROSSLINK" 62 "_BRD_CROSSLINK" 63 "_BRP_CROSSLINK" 64 "_CUL_CROSSLINK" 65 "_CUR_CROSSLINK" 66 "_FAD_CROSSLINK" 67 "_FAD2_CROSSLINK" 68 "_FAP_CROSSLINK" 69 "_FAP2_CROSSLINK" 70 "_HVB1_CROSSLINK" 71 "_HVB2_CROSSLINK" 72 "_KAD_CROSSLINK" 73 "_KAP_CROSSLINK" 74 "_PPBD_CROSSLINK" 75 "_PPBP_CROSSLINK" 76 "_RBL_CROSSLINK" 77 "_RBR_CROSSLINK" 78 "_SA2L_CROSSLINK" 79 "_SA2R_CROSSLINK" 80 "_SAD_CROSSLINK" 81 "_SAP_CROSSLINK" 82 "_BD1_HS_FAULT" 83 "_BDFP_HS_FAULT" 84 "_BFD_HS_FAULT" 85 "_BFP_HS_FAULT" 86 "_BLD_HS_FAULT" 87 "_BLP_HS_FAULT" 88 "_BP2D_HS_FAULT" 89 "_BP2P_HS_FAULT" 90 "_BRD_HS_FAULT" 91 "_BRP_HS_FAULT" 92 "_CUL_HS_FAULT" 93 "_CUR_HS_FAULT" 94 "_FAD_HS_FAULT" 95 "_FAD2_HS_FAULT" 96 "_FAP_HS_FAULT" 97 "_FAP2_HS_FAULT" 98 "_HVB1_HS_FAULT" 99 "_HVB2_HS_FAULT" 100 "_KAD_HS_FAULT" 101 "_KAP_HS_FAULT" 102 "_PPBD_HS_FAULT" 103 "_PPBP_HS_FAULT" 104 "_RBL_HS_FAULT" 105 "_RBR_HS_FAULT" 106 "_SA2L_HS_FAULT" 107 "_SA2R_HS_FAULT" 108 "_SAD_HS_FAULT" 109 "_SAP_HS_FAULT" 110 "_BD1_LEAK_TO_GND" 111 "_BDFP_LEAK_TO_GND" 112 "_BFD_LEAK_TO_GND" 113 "_BFP_LEAK_TO_GND" 114 "_BLD_LEAK_TO_GND" 115 "_BLP_LEAK_TO_GND" 116 "_BP2D_LEAK_TO_GND" 117 "_BP2P_LEAK_TO_GND" 118 "_BRD_LEAK_TO_GND" 119 "_BRP_LEAK_TO_GND" 120 "_CUL_LEAK_TO_GND" 121 "_CUR_LEAK_TO_GND" 122 "_FAD_LEAK_TO_GND" 123 "_FAD2_LEAK_TO_GND" 124 "_FAP_LEAK_TO_GND" 125 "_FAP2_LEAK_TO_GND" 126 "_HVB1_LEAK_TO_GND" 127 "_HVB2_LEAK_TO_GND" 128 "_KAD_LEAK_TO_GND" 129 "_KAP_LEAK_TO_GND" 130 "_PPBD_LEAK_TO_GND" 131 "_PPBP_LEAK_TO_GND" 132 "_RBL_LEAK_TO_GND" 133 "_RBR_LEAK_TO_GND" 134 "_SA2L_LEAK_TO_GND" 135 "_SA2R_LEAK_TO_GND" 136 "_SAD_LEAK_TO_GND" 137 "_SAP_LEAK_TO_GND" 138 "_BD1_LEAK_TO_BAT" 139 "_BDFP_LEAK_TO_BAT" 140 "_BFD_LEAK_TO_BAT" 141 "_BFP_LEAK_TO_BAT" 142 "_BLD_LEAK_TO_BAT" 143 "_BLP_LEAK_TO_BAT" 144 "_BP2D_LEAK_TO_BAT" 145 "_BP2P_LEAK_TO_BAT" 146 "_BRD_LEAK_TO_BAT" 147 "_BRP_LEAK_TO_BAT" 148 "_CUL_LEAK_TO_BAT" 149 "_CUR_LEAK_TO_BAT" 150 "_FAD_LEAK_TO_BAT" 151 "_FAD2_LEAK_TO_BAT" 152 "_FAP_LEAK_TO_BAT" 153 "_FAP2_LEAK_TO_BAT" 154 "_HVB1_LEAK_TO_BAT" 155 "_HVB2_LEAK_TO_BAT" 156 "_KAD_LEAK_TO_BAT" 157 "_KAP_LEAK_TO_BAT" 158 "_PPBD_LEAK_TO_BAT" 159 "_PPBP_LEAK_TO_BAT" 160 "_RBL_LEAK_TO_BAT" 161 "_RBR_LEAK_TO_BAT" 162 "_SA2L_LEAK_TO_BAT" 163 "_SA2R_LEAK_TO_BAT" 164 "_SAD_LEAK_TO_BAT" 165 "_SAP_LEAK_TO_BAT" 166 "_BD1_LS_FAULT" 167 "_BDFP_LS_FAULT" 168 "_BFD_LS_FAULT" 169 "_BFP_LS_FAULT" 170 "_BLD_LS_FAULT" 171 "_BLP_LS_FAULT" 172 "_BP2D_LS_FAULT" 173 "_BP2P_LS_FAULT" 174 "_BRD_LS_FAULT" 175 "_BRP_LS_FAULT" 176 "_CUL_LS_FAULT" 177 "_CUR_LS_FAULT" 178 "_FAD_LS_FAULT" 179 "_FAD2_LS_FAULT" 180 "_FAP_LS_FAULT" 181 "_FAP2_LS_FAULT" 182 "_HVB1_LS_FAULT" 183 "_HVB2_LS_FAULT" 184 "_KAD_LS_FAULT" 185 "_KAP_LS_FAULT" 186 "_PPBD_LS_FAULT" 187 "_PPBP_LS_FAULT" 188 "_RBL_LS_FAULT" 189 "_RBR_LS_FAULT" 190 "_SA2L_LS_FAULT" 191 "_SA2R_LS_FAULT" 192 "_SAD_LS_FAULT" 193 "_SAP_LS_FAULT" 194 "_BD1_RES_TOO_HIGH" 195 "_BDFP_RES_TOO_HIGH" 196 "_BFD_RES_TOO_HIGH" 197 "_BFP_RES_TOO_HIGH" 198 "_BLD_RES_TOO_HIGH" 199 "_BLP_RES_TOO_HIGH" 200 "_BP2D_RES_TOO_HIGH" 201 "_BP2P_RES_TOO_HIGH" 202 "_BRD_RES_TOO_HIGH" 203 "_BRP_RES_TOO_HIGH" 204 "_CUL_RES_TOO_HIGH" 205 "_CUR_RES_TOO_HIGH" 206 "_FAD_RES_TOO_HIGH" 207 "_FAD2_RES_TOO_HIGH" 208 "_FAP_RES_TOO_HIGH" 209 "_FAP2_RES_TOO_HIGH" 210 "_HVB1_RES_TOO_HIGH" 211 "_HVB2_RES_TOO_HIGH" 212 "_KAD_RES_TOO_HIGH" 213 "_KAP_RES_TOO_HIGH" 214 "_PPBD_RES_TOO_HIGH" 215 "_PPBP_RES_TOO_HIGH" 216 "_RBL_RES_TOO_HIGH" 217 "_RBR_RES_TOO_HIGH" 218 "_SA2L_RES_TOO_HIGH" 219 "_SA2R_RES_TOO_HIGH" 220 "_SAD_RES_TOO_HIGH" 221 "_SAP_RES_TOO_HIGH" 222 "_BD1_RES_TOO_LOW" 223 "_BDFP_RES_TOO_LOW" 224 "_BFD_RES_TOO_LOW" 225 "_BFP_RES_TOO_LOW" 226 "_BLD_RES_TOO_LOW" 227 "_BLP_RES_TOO_LOW" 228 "_BP2D_RES_TOO_LOW" 229 "_BP2P_RES_TOO_LOW" 230 "_BRD_RES_TOO_LOW" 231 "_BRP_RES_TOO_LOW" 232 "_CUL_RES_TOO_LOW" 233 "_CUR_RES_TOO_LOW" 234 "_FAD_RES_TOO_LOW" 235 "_FAD2_RES_TOO_LOW" 236 "_FAP_RES_TOO_LOW" 237 "_FAP2_RES_TOO_LOW" 238 "_HVB1_RES_TOO_LOW" 239 "_HVB2_RES_TOO_LOW" 240 "_KAD_RES_TOO_LOW" 241 "_KAP_RES_TOO_LOW" 242 "_PPBD_RES_TOO_LOW" 243 "_PPBP_RES_TOO_LOW" 244 "_RBL_RES_TOO_LOW" 245 "_RBR_RES_TOO_LOW" 246 "_SA2L_RES_TOO_LOW" 247 "_SA2R_RES_TOO_LOW" 248 "_SAD_RES_TOO_LOW" 249 "_SAP_RES_TOO_LOW" 251 "_UNCONFIRMED_ACTIVATION_ARM_PPS" 252 "_PAAL_INVALID_CONFIG" 253 "_PADL_INVALID_CONFIG" 255 "_PADL_LEAK_TO_GND" 256 "_PAAL_LEAK_TO_BAT" 257 "_PADL_LEAK_TO_BAT" 258 "_PAAL_LEAK_TO_OPEN" 259 "_PADL_LEAK_TO_OPEN" 261 "_CRC_FAIL_ASIC_CNF" 262 "_SYC_DEFAULT_INIT_PAR_USAGE" 263 "_EXC_DEFAULT_INIT_PAR_USAGE" 264 "_PERM_ABORT_DL" 265 "_HAL_INT_OVERVOLTAGE_FAULT_SYC" 266 "_HAL_INT_OVERVOLTAGE_FAULT_EXC_1" 267 "_HAL_INT_OVERVOLTAGE_FAULT_EXC_2" 268 "_HAL_INT_UNDERVOLTAGE_FAULT_SYC" 269 "_HAL_INT_UNDERVOLTAGE_FAULT_EXC_1" 270 "_HAL_INT_UNDERVOLTAGE_FAULT_EXC_2" 271 "_SYC_EVZ_LOW" 272 "_INT_VOLT_FAULT_SYC" 273 "_INT_VOLT_FAULT_EXC_1" 274 "_INT_VOLT_FAULT_EXC_2" 275 "_VZ_TOO_HIGH_FAULT_SYC" 276 "_VZ_TOO_HIGH_FAULT_EXC_1" 277 "_VZ_TOO_HIGH_FAULT_EXC_2" 278 "_VZ_TOO_LOW_FAULT_SYC" 279 "_VZ_TOO_LOW_FAULT_EXC_1" 280 "_VZ_TOO_LOW_FAULT_EXC_2" 281 "_AUTARKY_TIME" 282 "_PCB_CNF_CRC_FAIL" 283 "_CAPA_MEAS" 284 "_ARMx_FAULT" 285 "_LSENQ_FAULT" 286 "_SAFE_TXD_FAULT" 287 "_TESTMQ_FAULT" 288 "_SAFING_TRANSISTOR_1_FAULT" 289 "_ST1_VZ_FA_LOW_FAULT" 290 "_VSGC_FAULT" 291 "_M510_CRC_FAIL" 292 "_ECU_UNDERVOLTAGE" 293 "_ECU_OVERVOLTAGE" 294 "_ECU_STARTUP_SKIP_FAULT" 295 "_ER_STARTUP_SKIP_FAULT" 296 "_SWI_REF_FAULT_SYC" 297 "_SWITCH_CONFIG_MISMATCH" 298 "_CRC_FAIL_CONF_IASG" 299 "_CRC_FAIL_IASG_LIMITS" 300 "_CRC_FAIL_SWITCH_CONF" 301 "_CRC_FAIL_SWITCH_LIMITS" 302 "_BSD_INVALID_CONF" 303 "_BSP_INVALID_CONF" 304 "_BS2L_INVALID_CONF" 305 "_BS2R_INVALID_CONF" 306 "_BS3L_INVALID_CONF" 307 "_BS3R_INVALID_CONF" 308 "_PDD_INVALID_CONF" 309 "_PDP_INVALID_CONF" 310 "_PADS1_INVALID_CONF" 311 "_PADS2_INVALID_CONF" 312 "_SPSD_INVALID_CONF" 313 "_SPSP_INVALID_CONF" 314 "_BSD_CROSSLINK" 315 "_BSP_CROSSLINK" 316 "_BS2L_CROSSLINK" 317 "_BS2R_CROSSLINK" 318 "_BS3L_CROSSLINK" 319 "_BS3R_CROSSLINK" 320 "_PDD_CROSSLINK" 321 "_PDP_CROSSLINK" 322 "_PADS1_CROSSLINK" 323 "_PADS2_CROSSLINK" 324 "_SPSD_CROSSLINK" 325 "_SPSP_CROSSLINK" 326 "_BSD_LEAK_TO_GND" 327 "_BSP_LEAK_TO_GND" 328 "_BS2L_LEAK_TO_GND" 329 "_BS2R_LEAK_TO_GND" 331 "_BS3R_LEAK_TO_GND" 332 "_PDD_LEAK_TO_GND" 333 "_PDP_LEAK_TO_GND" 334 "_PADS1_LEAK_TO_GND" 335 "_PADS2_LEAK_TO_GND" 336 "_SPSD_LEAK_TO_GND" 337 "_SPSP_LEAK_TO_GND" 338 "_BSD_LEAK_TO_BAT" 339 "_BSP_LEAK_TO_BAT" 340 "_BS2L_LEAK_TO_BAT" 341 "_BS2R_LEAK_TO_BAT" 342 "_BS3L_LEAK_TO_BAT" 343 "_BS3R_LEAK_TO_BAT" 344 "_PDD_LEAK_TO_BAT" 345 "_PDP_LEAK_TO_BAT" 346 "_PADS1_LEAK_TO_BAT" 347 "_PADS2_LEAK_TO_BAT" 348 "_SPSD_LEAK_TO_BAT" 349 "_SPSP_LEAK_TO_BAT" 350 "_BSD_OPEN" 351 "_BSP_OPEN" 352 "_BS2L_OPEN" 353 "_BS2R_OPEN" 354 "_BS3L_OPEN" 355 "_BS3R_OPEN" 356 "_PDD_OPEN" 357 "_PDP_OPEN" 358 "_PADS1_OPEN" 359 "_PADS2_OPEN" 360 "_SPSD_OPEN" 361 "_SPSP_OPEN" 362 "_BSD_INVALID_RANGE" 363 "_BSP_INVALID_RANGE" 364 "_BS2L_INVALID_RANGE" 365 "_BS2R_INVALID_RANGE" 366 "_BS3L_INVALID_RANGE" 367 "_BS3R_INVALID_RANGE" 368 "_PDD_INVALID_RANGE" 369 "_PDP_INVALID_RANGE" 370 "_PADS1_INVALID_RANGE" 371 "_PADS2_INVALID_RANGE" 372 "_SPSD_INVALID_RANGE" 373 "_SPSP_INVALID_RANGE" 374 "_BSD_SHORT" 375 "_BSP_SHORT" 376 "_BS2L_SHORT" 377 "_BS2R_SHORT" 378 "_BS3R_SHORT" 379 "_PDD_SHORT" 380 "_PDP_SHORT" 381 "_PADS1_SHORT" 382 "_PADS2_SHORT" 383 "_SPSD_SHORT" 384 "_SPSP_SHORT" 385 "_CRC_FAIL_LD_LIMITS" 386 "_LD2_PIN_OPEN" 387 "_CRC_FAIL_COMBO_CONF" 388 "_COMBO_1_ACC_X_SIGNAL_FAILURE" 389 "_COMBO_1_ACC_Y_SIGNAL_FAILURE" 390 "_COMBO_1_ACC_Z_SIGNAL_FAILURE" 391 "_COMBO_1_COMMON_DIGITAL_FAILED" 392 "_COMBO_1_COMMON_EMC_PSRR_FAILED" 393 "_COMBO_1_COMMON_FW_FAILED" 394 "_COMBO_1_COMMON_MEMORY_FAILED" 395 "_COMBO_1_COMMON_SETTINGS_FAILED" 396 "_COMBO_1_COMMON_UC_WD_FAILED" 397 "_COMBO_1_COMP_FAILURE" 398 "_COMBO_1_VOLTAGE_SUPPY_FAILURE" 399 "_COMBO_1_IDENTIFICATION_FAILED" 400 "_COMBO_1_LOCK_SENSOR_FAILED" 401 "_COMBO_1_COMMUNICATION_ERROR" 402 "_COMBO_1_CONFIG_FAILED" 403 "_COMBO_1_LOWG_X_RANGE" 404 "_COMBO_1_LOWG_Y_RANGE" 405 "_COMBO_1_RATE_X_SIGNAL_FAILURE" 406 "_COMBO_1_RATE_Z_SIGNAL_FAILURE" 407 "_COMBO_1_SELFTEST_FAILED" 408 "_COMBO_1_UNEXPECTED_SELFTEST_RUNNING" 409 "_COMBO_1_WZ_RANGE" 410 "_COMBO_1_TEMP_RANGE" 411 "_COMBO_2_ACC_X_SIGNAL_FAILURE" 412 "_COMBO_2_ACC_Y_SIGNAL_FAILURE" 413 "_COMBO_2_ACC_Z_SIGNAL_FAILURE" 414 "_COMBO_2_COMMON_DIGITAL_FAILED" 415 "_COMBO_2_COMMON_EMC_PSRR_FAILED" 416 "_COMBO_2_COMMON_FW_FAILED" 417 "_COMBO_2_COMMON_MEMORY_FAILED" 418 "_COMBO_2_COMMON_SETTINGS_FAILED" 419 "_COMBO_2_COMMON_UC_WD_FAILED" 420 "_COMBO_2_COMP_FAILURE" 421 "_COMBO_2_VOLTAGE_SUPPY_FAILURE" 422 "_COMBO_2_IDENTIFICATION_FAILED" 423 "_COMBO_2_LOCK_SENSOR_FAILED" 424 "_COMBO_2_COMMUNICATION_ERROR" 425 "_COMBO_2_CONFIG_FAILED" 426 "_COMBO_2_LOWG_X_RANGE" 427 "_COMBO_2_LOWG_Y_RANGE" 428 "_COMBO_2_RATE_X_SIGNAL_FAILURE" 429 "_COMBO_2_RATE_Z_SIGNAL_FAILURE" 430 "_COMBO_2_SELFTEST_FAILED" 431 "_COMBO_2_UNEXPECTED_SELFTEST_RUNNING" 432 "_COMBO_2_WZ_RANGE" 433 "_COMBO_2_TEMP_RANGE" 434 "_CRC_FAIL_ROSF_CONFIG" 435 "_ROLL_SPI_MONITOR_FAULT" 436 "_CRC_FAIL_SAT_CONFIG" 437 "_SAT_SPI_PARITY_ERROR" 438 "_SAT_B_C_X_COMMUNICATION" 439 "_SAT_B_L_P_COMMUNICATION" 440 "_SAT_B_L_X_COMMUNICATION" 441 "_SAT_B_R_P_COMMUNICATION" 442 "_SAT_B_R_X_COMMUNICATION" 443 "_SAT_BP_L_X_COMMUNICATION" 444 "_SAT_BP_L_Y_COMMUNICATION" 445 "_SAT_BP_R_X_COMMUNICATION" 446 "_SAT_BP_R_Y_COMMUNICATION" 447 "_SAT_CP_L_Y_COMMUNICATION" 448 "_SAT_CP_R_Y_COMMUNICATION" 449 "_SAT_DO_L_P_COMMUNICATION" 450 "_SAT_DO_R_P_COMMUNICATION" 451 "_SAT_F_L_X_COMMUNICATION" 452 "_SAT_F_L_Y_COMMUNICATION" 453 "_SAT_F_R_X_COMMUNICATION" 454 "_SAT_F_R_Y_COMMUNICATION" 455 "_SAT_HV_C_X_COMMUNICATION" 456 "_SAT_HV_C_Y_COMMUNICATION" 457 "_SAT_B_C_X_CONFIG" 458 "_SAT_B_L_P_CONFIG" 459 "_SAT_B_L_X_CONFIG" 460 "_SAT_B_R_P_CONFIG" 461 "_SAT_B_R_X_CONFIG" 462 "_SAT_BP_L_X_CONFIG" 463 "_SAT_BP_L_Y_CONFIG" 464 "_SAT_BP_R_X_CONFIG" 465 "_SAT_BP_R_Y_CONFIG" 466 "_SAT_CP_L_Y_CONFIG" 467 "_SAT_CP_R_Y_CONFIG" 468 "_SAT_DO_L_P_CONFIG" 469 "_SAT_DO_R_P_CONFIG" 470 "_SAT_F_L_X_CONFIG" 471 "_SAT_F_L_Y_CONFIG" 472 "_SAT_F_R_X_CONFIG" 473 "_SAT_F_R_Y_CONFIG" 474 "_SAT_HV_C_X_CONFIG" 475 "_SAT_HV_C_Y_CONFIG" 476 "_SAT_B_C_X_CROSSLINK" 477 "_SAT_B_L_P_CROSSLINK" 478 "_SAT_B_L_X_CROSSLINK" 479 "_SAT_B_R_P_CROSSLINK" 480 "_SAT_B_R_X_CROSSLINK" 481 "_SAT_BP_L_X_CROSSLINK" 482 "_SAT_BP_L_Y_CROSSLINK" 483 "_SAT_BP_R_X_CROSSLINK" 484 "_SAT_BP_R_Y_CROSSLINK" 485 "_SAT_CP_L_Y_CROSSLINK" 486 "_SAT_CP_R_Y_CROSSLINK" 487 "_SAT_DO_L_P_CROSSLINK" 488 "_SAT_DO_R_P_CROSSLINK" 489 "_SAT_F_L_X_CROSSLINK" 490 "_SAT_F_L_Y_CROSSLINK" 491 "_SAT_F_R_X_CROSSLINK" 492 "_SAT_F_R_Y_CROSSLINK" 493 "_SAT_HV_C_X_CROSSLINK" 494 "_SAT_HV_C_Y_CROSSLINK" 495 "_SAT_B_C_X_LEAK_TO_GND" 496 "_SAT_B_L_P_LEAK_TO_GND" 497 "_SAT_B_L_X_LEAK_TO_GND" 498 "_SAT_B_R_P_LEAK_TO_GND" 499 "_SAT_B_R_X_LEAK_TO_GND" 500 "_SAT_BP_L_X_LEAK_TO_GND" 501 "_SAT_BP_L_Y_LEAK_TO_GND" 502 "_SAT_BP_R_X_LEAK_TO_GND" 503 "_SAT_BP_R_Y_LEAK_TO_GND" 504 "_SAT_CP_L_Y_LEAK_TO_GND" 505 "_SAT_CP_R_Y_LEAK_TO_GND" 506 "_SAT_DO_L_P_LEAK_TO_GND" 507 "_SAT_DO_R_P_LEAK_TO_GND" 508 "_SAT_F_L_X_LEAK_TO_GND" 509 "_SAT_F_L_Y_LEAK_TO_GND" 510 "_SAT_F_R_X_LEAK_TO_GND" 511 "_SAT_F_R_Y_LEAK_TO_GND" 512 "_SAT_HV_C_X_LEAK_TO_GND" 513 "_SAT_HV_C_Y_LEAK_TO_GND" 514 "_SAT_B_C_X_LEAK_TO_UBATT" 515 "_SAT_B_L_P_LEAK_TO_UBATT" 516 "_SAT_B_L_X_LEAK_TO_UBATT" 517 "_SAT_B_R_P_LEAK_TO_UBATT" 518 "_SAT_B_R_X_LEAK_TO_UBATT" 519 "_SAT_BP_L_X_LEAK_TO_UBATT" 520 "_SAT_BP_L_Y_LEAK_TO_UBATT" 521 "_SAT_BP_R_X_LEAK_TO_UBATT" 522 "_SAT_BP_R_Y_LEAK_TO_UBATT" 523 "_SAT_CP_L_Y_LEAK_TO_UBATT" 524 "_SAT_CP_R_Y_LEAK_TO_UBATT" 525 "_SAT_DO_L_P_LEAK_TO_UBATT" 526 "_SAT_DO_R_P_LEAK_TO_UBATT" 527 "_SAT_F_L_X_LEAK_TO_UBATT" 528 "_SAT_F_L_Y_LEAK_TO_UBATT" 529 "_SAT_F_R_X_LEAK_TO_UBATT" 530 "_SAT_F_R_Y_LEAK_TO_UBATT" 531 "_SAT_HV_C_X_LEAK_TO_UBATT" 532 "_SAT_HV_C_Y_LEAK_TO_UBATT" 533 "_SAT_B_C_X_NOK_SI" 534 "_SAT_B_L_P_NOK_SI" 535 "_SAT_B_L_X_NOK_SI" 536 "_SAT_B_R_P_NOK_SI" 537 "_SAT_B_R_X_NOK_SI" 538 "_SAT_BP_L_X_NOK_SI" 539 "_SAT_BP_L_Y_NOK_SI" 540 "_SAT_BP_R_X_NOK_SI" 541 "_SAT_BP_R_Y_NOK_SI" 542 "_SAT_CP_L_Y_NOK_SI" 543 "_SAT_CP_R_Y_NOK_SI" 544 "_SAT_DO_L_P_NOK_SI" 545 "_SAT_DO_R_P_NOK_SI" 546 "_SAT_F_L_X_NOK_SI" 547 "_SAT_F_L_Y_NOK_SI" 548 "_SAT_F_R_X_NOK_SI" 549 "_SAT_F_R_Y_NOK_SI" 550 "_SAT_HV_C_X_NOK_SI" 551 "_SAT_HV_C_Y_NOK_SI" 552 "_SAT_B_C_X_OPEN_LINE" 553 "_SAT_B_L_P_OPEN_LINE" 554 "_SAT_B_L_X_OPEN_LINE" 555 "_SAT_B_R_P_OPEN_LINE" 556 "_SAT_B_R_X_OPEN_LINE" 557 "_SAT_BP_L_X_OPEN_LINE" 558 "_SAT_BP_L_Y_OPEN_LINE" 559 "_SAT_BP_R_X_OPEN_LINE" 560 "_SAT_BP_R_Y_OPEN_LINE" 561 "_SAT_CP_L_Y_OPEN_LINE" 562 "_SAT_CP_R_Y_OPEN_LINE" 563 "_SAT_DO_L_P_OPEN_LINE" 564 "_SAT_DO_R_P_OPEN_LINE" 565 "_SAT_F_L_X_OPEN_LINE" 566 "_SAT_F_L_Y_OPEN_LINE" 567 "_SAT_F_R_X_OPEN_LINE" 568 "_SAT_F_R_Y_OPEN_LINE" 569 "_SAT_HV_C_X_OPEN_LINE" 570 "_SAT_HV_C_Y_OPEN_LINE" 571 "_SAT_B_C_X_PARAMETER" 572 "_SAT_B_L_P_PARAMETER" 573 "_SAT_B_L_X_PARAMETER" 574 "_SAT_B_R_P_PARAMETER" 575 "_SAT_B_R_X_PARAMETER" 576 "_SAT_BP_L_X_PARAMETER" 577 "_SAT_BP_L_Y_PARAMETER" 578 "_SAT_BP_R_X_PARAMETER" 579 "_SAT_BP_R_Y_PARAMETER" 580 "_SAT_CP_L_Y_PARAMETER" 581 "_SAT_CP_R_Y_PARAMETER" 582 "_SAT_DO_L_P_PARAMETER" 583 "_SAT_DO_R_P_PARAMETER" 584 "_SAT_F_L_X_PARAMETER" 585 "_SAT_F_L_Y_PARAMETER" 586 "_SAT_F_R_X_PARAMETER" 587 "_SAT_F_R_Y_PARAMETER" 588 "_SAT_HV_C_X_PARAMETER" 589 "_SAT_HV_C_Y_PARAMETER" 590 "_SAT_DO_L_P_PLAUSIBILITY" 591 "_SAT_DO_R_P_PLAUSIBILITY" 592 "_SAT_B_L_P_PLAUSIBILITY" 593 "_SAT_B_R_P_PLAUSIBILITY" 594 "_SAT_B_C_X_SENSOR_DEFECT" 595 "_SAT_B_L_P_SENSOR_DEFECT" 596 "_SAT_B_L_X_SENSOR_DEFECT" 597 "_SAT_B_R_P_SENSOR_DEFECT" 598 "_SAT_B_R_X_SENSOR_DEFECT" 599 "_SAT_BP_L_X_SENSOR_DEFECT" 600 "_SAT_BP_L_Y_SENSOR_DEFECT" 601 "_SAT_BP_R_X_SENSOR_DEFECT" 602 "_SAT_BP_R_Y_SENSOR_DEFECT" 603 "_SAT_CP_L_Y_SENSOR_DEFECT" 604 "_SAT_CP_R_Y_SENSOR_DEFECT" 605 "_SAT_DO_L_P_SENSOR_DEFECT" 606 "_SAT_DO_R_P_SENSOR_DEFECT" 607 "_SAT_F_L_X_SENSOR_DEFECT" 608 "_SAT_F_L_Y_SENSOR_DEFECT" 609 "_SAT_F_R_X_SENSOR_DEFECT" 610 "_SAT_F_R_Y_SENSOR_DEFECT" 611 "_SAT_HV_C_X_SENSOR_DEFECT" 612 "_SAT_HV_C_Y_SENSOR_DEFECT" 613 "_SAT_IF1_VSAT_ERROR" 614 "_SAT_IF2_VSAT_ERROR" 615 "_SAT_IF3_VSAT_ERROR" 616 "_SAT_IF4_VSAT_ERROR" 617 "_SAT_IF5_VSAT_ERROR" 618 "_SAT_IF6_VSAT_ERROR" 619 "_SAT_IF7_VSAT_ERROR" 620 "_SAT_IF8_VSAT_ERROR" 621 "_SAT_IF9_VSAT_ERROR" 622 "_SAT_IF10_VSAT_ERROR" 623 "_SAT_IF11_VSAT_ERROR" 624 "_SAT_IF12_VSAT_ERROR" 625 "_SAT_IF13_VSAT_ERROR" 626 "_SAT_IF14_VSAT_ERROR" 627 "_SAT_IF15_VSAT_ERROR" 628 "_SAT_IF16_VSAT_ERROR" 629 "_ALGO_ISA_EEPROM_CRC_FAIL" 630 "_ALGO_MODAR_EEPROM_CRC_FAIL" 631 "_SIGNAL_FAULT_CHANNEL_X" 632 "_SIGNAL_FAULT_CHANNEL_Y" 633 "_SIGNAL_FAULT_CHANNEL_R" 634 "_SIGNAL_FAULT_CHANNEL_XQ" 635 "_SIGNAL_FAULT_CHANNEL_YQ" 636 "_SIGNAL_FAULT_CHANNEL_P" 637 "_SIGNAL_FAULT_CHANNEL_YLOW" 638 "_SIGNAL_FAULT_CHANNEL_Z" 639 "_MISMATCH_LAYOUT_EOL_MODAR_SWV" 640 "_MISMATCH_LAYOUT_EOL_ISA_SWV" 641 "_INVALID_SW_CONF_OF_SENSORS" 642 "_MODAR_DATAPREP" 643 "_ALGO_DATAPREP" 644 "_MODAR_DATAPREP_RAM_BUF_FULL" 645 "_ADC_CYCLIC_TEST" 646 "_RAM_CRC_FAIL" 647 "_PORT_SHORT_LSENQ" 648 "_NVM_FAILURE" 649 "_DETERRORHOOK" 650 "_MPU_EXCEPTION" 651 "_EXCEPTION" 652 "_STACK_OVER_THRESHOLD" 653 "_RESET" 654 "_UNCONFIRMED_ACTIVATION_ARM_OMNI" 655 "_UNCONFIRMED_ACTIVATION_ARM_FRONT" 656 "_DTC_0x900639_FH" 657 "_PAAL_LEAK_TO_GND" 658 "_LD1_PIN_OPEN" 659 "_DTC_0x900394_FH" 660 "_ASICS_M720_CRC_FAIL" 661 "_PCB_M720_CRC_FAIL" 662 "_ROM_CRC_FAIL" 663 "_DTC_0x900259_FH" 664 "_BS3L_LEAK_TO_GND" 665 "_BS3L_SHORT" 666 "_DTC_0x900354_FH" DEFAULT_VALUE "" /end COMPU_VTAB
/begin COMPU_VTAB FAULT_STATUS "Decoding table for the fault status" TAB_VERB 2 0 "INACTIVE" 1024 "ACTIVE" DEFAULT_VALUE "" /end COMPU_VTAB
/begin COMPU_VTAB INFORMATION_CODES_S1 "Interpretation of the information codes" TAB_VERB 769 0 "_VEH_SPEED_CRCERROR" 0 "_ECM_ABSENT" 0 "_VDC_ABSENT" 0 "_METER_ABSENT" 0 "_BCM_ABSENT" 0 "_IDM_ABSENT" 0 "_USM_ABSENT" 0 "_HEVC_ABSENT" 0 "_ATCU_ABSENT" 0 "_ADAS_ABSENT" 0 "_EPKB_ABSENT" 0 "_EBA_ABSENT" 0 "_IVI_ABSENT" 0 "_IVC_ABSENT" 0 "_ARMQ_SAT_FAULT" 0 "_IASG_CROSSLINK_DETECTED" 1 "_SENSOR_CONFIG_ERROR" 2 "_DIGITAL_SENSOR1_INIT_FAULT" 3 "_DIGITAL_SENSOR1_CHANNEL0_TEST_FAULT" 4 "_DIGITAL_SENSOR1_CHANNEL1_TEST_FAULT" 5 "_DIGITAL_SENSOR1_COMM_FAULT" 6 "_DIGITAL_SENSOR1_CLOCK_COUNTER_FAULT" 7 "_DIGITAL_SENSOR1_PERMANANT_DEFECT" 8 "_DIGITAL_SENSOR2_INIT_FAULT" 9 "_DIGITAL_SENSOR2_CHANNEL0_TEST_FAULT" 10 "_DIGITAL_SENSOR2_CHANNEL1_TEST_FAULT" 11 "_DIGITAL_SENSOR2_COMM_FAULT" 12 "_DIGITAL_SENSOR2_CLOCK_COUNTER_FAULT" 13 "_DIGITAL_SENSOR2_PERMANANT_DEFECT" 14 "_CAN_BUSOFF" 15 "_CRC_FAIL_CO_CALIBRATION" 16 "_REF_SQ_FAULT_SYC" 17 "_REF_SQ_FAULT_EXC_1" 18 "_REF_SQ_FAULT_EXC_2" 19 "_CONFIG_SQUIB_CURRENT_TIME_SYC" 20 "_CONFIG_SQUIB_CURRENT_TIME_EXC1" 21 "_CONFIG_SQUIB_CURRENT_TIME_EXC2" 22 "_SQ_CONFIG_MISMATCH" 23 "_CRC_FAIL_SQUIB_LIMITS" 24 "_CRC_FAIL_DEPLOY_CONFIG" 25 "_CRC_FAIL_SQUIB_CONFIG" 26 "_BD1_INVALID_CONF" 27 "_BDFP_INVALID_CONF" 28 "_BFD_INVALID_CONF" 29 "_BFP_INVALID_CONF" 30 "_BLD_INVALID_CONF" 31 "_BLP_INVALID_CONF" 32 "_BP2D_INVALID_CONF" 33 "_BP2P_INVALID_CONF" 34 "_BRD_INVALID_CONF" 35 "_BRP_INVALID_CONF" 36 "_CUL_INVALID_CONF" 37 "_CUR_INVALID_CONF" 38 "_FAD_INVALID_CONF" 39 "_FAD2_INVALID_CONF" 40 "_FAP_INVALID_CONF" 41 "_FAP2_INVALID_CONF" 42 "_HVB1_INVALID_CONF" 43 "_HVB2_INVALID_CONF" 44 "_KAD_INVALID_CONF" 45 "_KAP_INVALID_CONF" 46 "_PPBD_INVALID_CONF" 47 "_PPBP_INVALID_CONF" 48 "_RBL_INVALID_CONF" 49 "_RBR_INVALID_CONF" 50 "_SA2L_INVALID_CONF" 51 "_SA2R_INVALID_CONF" 52 "_SAD_INVALID_CONF" 53 "_SAP_INVALID_CONF" 54 "_BD1_CROSSLINK" 55 "_BDFP_CROSSLINK" 56 "_BFD_CROSSLINK" 57 "_BFP_CROSSLINK" 58 "_BLD_CROSSLINK" 59 "_BLP_CROSSLINK" 60 "_BP2D_CROSSLINK" 61 "_BP2P_CROSSLINK" 62 "_BRD_CROSSLINK" 63 "_BRP_CROSSLINK" 64 "_CUL_CROSSLINK" 65 "_CUR_CROSSLINK" 66 "_FAD_CROSSLINK" 67 "_FAD2_CROSSLINK" 68 "_FAP_CROSSLINK" 69 "_FAP2_CROSSLINK" 70 "_HVB1_CROSSLINK" 71 "_HVB2_CROSSLINK" 72 "_KAD_CROSSLINK" 73 "_KAP_CROSSLINK" 74 "_PPBD_CROSSLINK" 75 "_PPBP_CROSSLINK" 76 "_RBL_CROSSLINK" 77 "_RBR_CROSSLINK" 78 "_SA2L_CROSSLINK" 79 "_SA2R_CROSSLINK" 80 "_SAD_CROSSLINK" 81 "_SAP_CROSSLINK" 82 "_BD1_HS_FAULT" 83 "_BDFP_HS_FAULT" 84 "_BFD_HS_FAULT" 85 "_BFP_HS_FAULT" 86 "_BLD_HS_FAULT" 87 "_BLP_HS_FAULT" 88 "_BP2D_HS_FAULT" 89 "_BP2P_HS_FAULT" 90 "_BRD_HS_FAULT" 91 "_BRP_HS_FAULT" 92 "_CUL_HS_FAULT" 93 "_CUR_HS_FAULT" 94 "_FAD_HS_FAULT" 95 "_FAD2_HS_FAULT" 96 "_FAP_HS_FAULT" 97 "_FAP2_HS_FAULT" 98 "_HVB1_HS_FAULT" 99 "_HVB2_HS_FAULT" 100 "_KAD_HS_FAULT" 101 "_KAP_HS_FAULT" 102 "_PPBD_HS_FAULT" 103 "_PPBP_HS_FAULT" 104 "_RBL_HS_FAULT" 105 "_RBR_HS_FAULT" 106 "_SA2L_HS_FAULT" 107 "_SA2R_HS_FAULT" 108 "_SAD_HS_FAULT" 109 "_SAP_HS_FAULT" 110 "_BD1_LEAK_TO_GND" 111 "_BDFP_LEAK_TO_GND" 112 "_BFD_LEAK_TO_GND" 113 "_BFP_LEAK_TO_GND" 114 "_BLD_LEAK_TO_GND" 115 "_BLP_LEAK_TO_GND" 116 "_BP2D_LEAK_TO_GND" 117 "_BP2P_LEAK_TO_GND" 118 "_BRD_LEAK_TO_GND" 119 "_BRP_LEAK_TO_GND" 120 "_CUL_LEAK_TO_GND" 121 "_CUR_LEAK_TO_GND" 122 "_FAD_LEAK_TO_GND" 123 "_FAD2_LEAK_TO_GND" 124 "_FAP_LEAK_TO_GND" 125 "_FAP2_LEAK_TO_GND" 126 "_HVB1_LEAK_TO_GND" 127 "_HVB2_LEAK_TO_GND" 128 "_KAD_LEAK_TO_GND" 129 "_KAP_LEAK_TO_GND" 130 "_PPBD_LEAK_TO_GND" 131 "_PPBP_LEAK_TO_GND" 132 "_RBL_LEAK_TO_GND" 133 "_RBR_LEAK_TO_GND" 134 "_SA2L_LEAK_TO_GND" 135 "_SA2R_LEAK_TO_GND" 136 "_SAD_LEAK_TO_GND" 137 "_SAP_LEAK_TO_GND" 138 "_BD1_LEAK_TO_BAT" 139 "_BDFP_LEAK_TO_BAT" 140 "_BFD_LEAK_TO_BAT" 141 "_BFP_LEAK_TO_BAT" 142 "_BLD_LEAK_TO_BAT" 143 "_BLP_LEAK_TO_BAT" 144 "_BP2D_LEAK_TO_BAT" 145 "_BP2P_LEAK_TO_BAT" 146 "_BRD_LEAK_TO_BAT" 147 "_BRP_LEAK_TO_BAT" 148 "_CUL_LEAK_TO_BAT" 149 "_CUR_LEAK_TO_BAT" 150 "_FAD_LEAK_TO_BAT" 151 "_FAD2_LEAK_TO_BAT" 152 "_FAP_LEAK_TO_BAT" 153 "_FAP2_LEAK_TO_BAT" 154 "_HVB1_LEAK_TO_BAT" 155 "_HVB2_LEAK_TO_BAT" 156 "_KAD_LEAK_TO_BAT" 157 "_KAP_LEAK_TO_BAT" 158 "_PPBD_LEAK_TO_BAT" 159 "_PPBP_LEAK_TO_BAT" 160 "_RBL_LEAK_TO_BAT" 161 "_RBR_LEAK_TO_BAT" 162 "_SA2L_LEAK_TO_BAT" 163 "_SA2R_LEAK_TO_BAT" 164 "_SAD_LEAK_TO_BAT" 165 "_SAP_LEAK_TO_BAT" 166 "_BD1_LS_FAULT" 167 "_BDFP_LS_FAULT" 168 "_BFD_LS_FAULT" 169 "_BFP_LS_FAULT" 170 "_BLD_LS_FAULT" 171 "_BLP_LS_FAULT" 172 "_BP2D_LS_FAULT" 173 "_BP2P_LS_FAULT" 174 "_BRD_LS_FAULT" 175 "_BRP_LS_FAULT" 176 "_CUL_LS_FAULT" 177 "_CUR_LS_FAULT" 178 "_FAD_LS_FAULT" 179 "_FAD2_LS_FAULT" 180 "_FAP_LS_FAULT" 181 "_FAP2_LS_FAULT" 182 "_HVB1_LS_FAULT" 183 "_HVB2_LS_FAULT" 184 "_KAD_LS_FAULT" 185 "_KAP_LS_FAULT" 186 "_PPBD_LS_FAULT" 187 "_PPBP_LS_FAULT" 188 "_RBL_LS_FAULT" 189 "_RBR_LS_FAULT" 190 "_SA2L_LS_FAULT" 191 "_SA2R_LS_FAULT" 192 "_SAD_LS_FAULT" 193 "_SAP_LS_FAULT" 194 "_BD1_RES_TOO_HIGH" 195 "_BDFP_RES_TOO_HIGH" 196 "_BFD_RES_TOO_HIGH" 197 "_BFP_RES_TOO_HIGH" 198 "_BLD_RES_TOO_HIGH" 199 "_BLP_RES_TOO_HIGH" 200 "_BP2D_RES_TOO_HIGH" 201 "_BP2P_RES_TOO_HIGH" 202 "_BRD_RES_TOO_HIGH" 203 "_BRP_RES_TOO_HIGH" 204 "_CUL_RES_TOO_HIGH" 205 "_CUR_RES_TOO_HIGH" 206 "_FAD_RES_TOO_HIGH" 207 "_FAD2_RES_TOO_HIGH" 208 "_FAP_RES_TOO_HIGH" 209 "_FAP2_RES_TOO_HIGH" 210 "_HVB1_RES_TOO_HIGH" 211 "_HVB2_RES_TOO_HIGH" 212 "_KAD_RES_TOO_HIGH" 213 "_KAP_RES_TOO_HIGH" 214 "_PPBD_RES_TOO_HIGH" 215 "_PPBP_RES_TOO_HIGH" 216 "_RBL_RES_TOO_HIGH" 217 "_RBR_RES_TOO_HIGH" 218 "_SA2L_RES_TOO_HIGH" 219 "_SA2R_RES_TOO_HIGH" 220 "_SAD_RES_TOO_HIGH" 221 "_SAP_RES_TOO_HIGH" 222 "_BD1_RES_TOO_LOW" 223 "_BDFP_RES_TOO_LOW" 224 "_BFD_RES_TOO_LOW" 225 "_BFP_RES_TOO_LOW" 226 "_BLD_RES_TOO_LOW" 227 "_BLP_RES_TOO_LOW" 228 "_BP2D_RES_TOO_LOW" 229 "_BP2P_RES_TOO_LOW" 230 "_BRD_RES_TOO_LOW" 231 "_BRP_RES_TOO_LOW" 232 "_CUL_RES_TOO_LOW" 233 "_CUR_RES_TOO_LOW" 234 "_FAD_RES_TOO_LOW" 235 "_FAD2_RES_TOO_LOW" 236 "_FAP_RES_TOO_LOW" 237 "_FAP2_RES_TOO_LOW" 238 "_HVB1_RES_TOO_LOW" 239 "_HVB2_RES_TOO_LOW" 240 "_KAD_RES_TOO_LOW" 241 "_KAP_RES_TOO_LOW" 242 "_PPBD_RES_TOO_LOW" 243 "_PPBP_RES_TOO_LOW" 244 "_RBL_RES_TOO_LOW" 245 "_RBR_RES_TOO_LOW" 246 "_SA2L_RES_TOO_LOW" 247 "_SA2R_RES_TOO_LOW" 248 "_SAD_RES_TOO_LOW" 249 "_SAP_RES_TOO_LOW" 251 "_UNCONFIRMED_ACTIVATION_ARM_PPS" 252 "_PAAL_INVALID_CONFIG" 253 "_PADL_INVALID_CONFIG" 255 "_PADL_LEAK_TO_GND" 256 "_PAAL_LEAK_TO_BAT" 257 "_PADL_LEAK_TO_BAT" 258 "_PAAL_LEAK_TO_OPEN" 259 "_PADL_LEAK_TO_OPEN" 261 "_CRC_FAIL_ASIC_CNF" 262 "_SYC_DEFAULT_INIT_PAR_USAGE" 263 "_EXC_DEFAULT_INIT_PAR_USAGE" 264 "_PERM_ABORT_DL" 265 "_HAL_INT_OVERVOLTAGE_FAULT_SYC" 266 "_HAL_INT_OVERVOLTAGE_FAULT_EXC_1" 267 "_HAL_INT_OVERVOLTAGE_FAULT_EXC_2" 268 "_HAL_INT_UNDERVOLTAGE_FAULT_SYC" 269 "_HAL_INT_UNDERVOLTAGE_FAULT_EXC_1" 270 "_HAL_INT_UNDERVOLTAGE_FAULT_EXC_2" 271 "_SYC_EVZ_LOW" 272 "_INT_VOLT_FAULT_SYC" 273 "_INT_VOLT_FAULT_EXC_1" 274 "_INT_VOLT_FAULT_EXC_2" 275 "_VZ_TOO_HIGH_FAULT_SYC" 276 "_VZ_TOO_HIGH_FAULT_EXC_1" 277 "_VZ_TOO_HIGH_FAULT_EXC_2" 278 "_VZ_TOO_LOW_FAULT_SYC" 279 "_VZ_TOO_LOW_FAULT_EXC_1" 280 "_VZ_TOO_LOW_FAULT_EXC_2" 281 "_AUTARKY_TIME" 282 "_PCB_CNF_CRC_FAIL" 283 "_CAPA_MEAS" 284 "_ARMx_FAULT" 285 "_LSENQ_FAULT" 286 "_SAFE_TXD_FAULT" 287 "_TESTMQ_FAULT" 288 "_SAFING_TRANSISTOR_1_FAULT" 289 "_ST1_VZ_FA_LOW_FAULT" 290 "_VSGC_FAULT" 291 "_M510_CRC_FAIL" 292 "_ECU_UNDERVOLTAGE" 293 "_ECU_OVERVOLTAGE" 294 "_ECU_STARTUP_SKIP_FAULT" 295 "_ER_STARTUP_SKIP_FAULT" 296 "_SWI_REF_FAULT_SYC" 297 "_SWITCH_CONFIG_MISMATCH" 298 "_CRC_FAIL_CONF_IASG" 299 "_CRC_FAIL_IASG_LIMITS" 300 "_CRC_FAIL_SWITCH_CONF" 301 "_CRC_FAIL_SWITCH_LIMITS" 302 "_BSD_INVALID_CONF" 303 "_BSP_INVALID_CONF" 304 "_BS2L_INVALID_CONF" 305 "_BS2R_INVALID_CONF" 306 "_BS3L_INVALID_CONF" 307 "_BS3R_INVALID_CONF" 308 "_PDD_INVALID_CONF" 309 "_PDP_INVALID_CONF" 310 "_PADS1_INVALID_CONF" 311 "_PADS2_INVALID_CONF" 312 "_SPSD_INVALID_CONF" 313 "_SPSP_INVALID_CONF" 314 "_BSD_CROSSLINK" 315 "_BSP_CROSSLINK" 316 "_BS2L_CROSSLINK" 317 "_BS2R_CROSSLINK" 318 "_BS3L_CROSSLINK" 319 "_BS3R_CROSSLINK" 320 "_PDD_CROSSLINK" 321 "_PDP_CROSSLINK" 322 "_PADS1_CROSSLINK" 323 "_PADS2_CROSSLINK" 324 "_SPSD_CROSSLINK" 325 "_SPSP_CROSSLINK" 326 "_BSD_LEAK_TO_GND" 327 "_BSP_LEAK_TO_GND" 328 "_BS2L_LEAK_TO_GND" 329 "_BS2R_LEAK_TO_GND" 331 "_BS3R_LEAK_TO_GND" 332 "_PDD_LEAK_TO_GND" 333 "_PDP_LEAK_TO_GND" 334 "_PADS1_LEAK_TO_GND" 335 "_PADS2_LEAK_TO_GND" 336 "_SPSD_LEAK_TO_GND" 337 "_SPSP_LEAK_TO_GND" 338 "_BSD_LEAK_TO_BAT" 339 "_BSP_LEAK_TO_BAT" 340 "_BS2L_LEAK_TO_BAT" 341 "_BS2R_LEAK_TO_BAT" 342 "_BS3L_LEAK_TO_BAT" 343 "_BS3R_LEAK_TO_BAT" 344 "_PDD_LEAK_TO_BAT" 345 "_PDP_LEAK_TO_BAT" 346 "_PADS1_LEAK_TO_BAT" 347 "_PADS2_LEAK_TO_BAT" 348 "_SPSD_LEAK_TO_BAT" 349 "_SPSP_LEAK_TO_BAT" 350 "_BSD_OPEN" 351 "_BSP_OPEN" 352 "_BS2L_OPEN" 353 "_BS2R_OPEN" 354 "_BS3L_OPEN" 355 "_BS3R_OPEN" 356 "_PDD_OPEN" 357 "_PDP_OPEN" 358 "_PADS1_OPEN" 359 "_PADS2_OPEN" 360 "_SPSD_OPEN" 361 "_SPSP_OPEN" 362 "_BSD_INVALID_RANGE" 363 "_BSP_INVALID_RANGE" 364 "_BS2L_INVALID_RANGE" 365 "_BS2R_INVALID_RANGE" 366 "_BS3L_INVALID_RANGE" 367 "_BS3R_INVALID_RANGE" 368 "_PDD_INVALID_RANGE" 369 "_PDP_INVALID_RANGE" 370 "_PADS1_INVALID_RANGE" 371 "_PADS2_INVALID_RANGE" 372 "_SPSD_INVALID_RANGE" 373 "_SPSP_INVALID_RANGE" 374 "_BSD_SHORT" 375 "_BSP_SHORT" 376 "_BS2L_SHORT" 377 "_BS2R_SHORT" 378 "_BS3R_SHORT" 379 "_PDD_SHORT" 380 "_PDP_SHORT" 381 "_PADS1_SHORT" 382 "_PADS2_SHORT" 383 "_SPSD_SHORT" 384 "_SPSP_SHORT" 385 "_CRC_FAIL_LD_LIMITS" 386 "_LD2_PIN_OPEN" 387 "_CRC_FAIL_COMBO_CONF" 388 "_COMBO_1_ACC_X_SIGNAL_FAILURE" 389 "_COMBO_1_ACC_Y_SIGNAL_FAILURE" 390 "_COMBO_1_ACC_Z_SIGNAL_FAILURE" 391 "_COMBO_1_COMMON_DIGITAL_FAILED" 392 "_COMBO_1_COMMON_EMC_PSRR_FAILED" 393 "_COMBO_1_COMMON_FW_FAILED" 394 "_COMBO_1_COMMON_MEMORY_FAILED" 395 "_COMBO_1_COMMON_SETTINGS_FAILED" 396 "_COMBO_1_COMMON_UC_WD_FAILED" 397 "_COMBO_1_COMP_FAILURE" 398 "_COMBO_1_VOLTAGE_SUPPY_FAILURE" 399 "_COMBO_1_IDENTIFICATION_FAILED" 400 "_COMBO_1_LOCK_SENSOR_FAILED" 401 "_COMBO_1_COMMUNICATION_ERROR" 402 "_COMBO_1_CONFIG_FAILED" 403 "_COMBO_1_LOWG_X_RANGE" 404 "_COMBO_1_LOWG_Y_RANGE" 405 "_COMBO_1_RATE_X_SIGNAL_FAILURE" 406 "_COMBO_1_RATE_Z_SIGNAL_FAILURE" 407 "_COMBO_1_SELFTEST_FAILED" 408 "_COMBO_1_UNEXPECTED_SELFTEST_RUNNING" 409 "_COMBO_1_WZ_RANGE" 410 "_COMBO_1_TEMP_RANGE" 411 "_COMBO_2_ACC_X_SIGNAL_FAILURE" 412 "_COMBO_2_ACC_Y_SIGNAL_FAILURE" 413 "_COMBO_2_ACC_Z_SIGNAL_FAILURE" 414 "_COMBO_2_COMMON_DIGITAL_FAILED" 415 "_COMBO_2_COMMON_EMC_PSRR_FAILED" 416 "_COMBO_2_COMMON_FW_FAILED" 417 "_COMBO_2_COMMON_MEMORY_FAILED" 418 "_COMBO_2_COMMON_SETTINGS_FAILED" 419 "_COMBO_2_COMMON_UC_WD_FAILED" 420 "_COMBO_2_COMP_FAILURE" 421 "_COMBO_2_VOLTAGE_SUPPY_FAILURE" 422 "_COMBO_2_IDENTIFICATION_FAILED" 423 "_COMBO_2_LOCK_SENSOR_FAILED" 424 "_COMBO_2_COMMUNICATION_ERROR" 425 "_COMBO_2_CONFIG_FAILED" 426 "_COMBO_2_LOWG_X_RANGE" 427 "_COMBO_2_LOWG_Y_RANGE" 428 "_COMBO_2_RATE_X_SIGNAL_FAILURE" 429 "_COMBO_2_RATE_Z_SIGNAL_FAILURE" 430 "_COMBO_2_SELFTEST_FAILED" 431 "_COMBO_2_UNEXPECTED_SELFTEST_RUNNING" 432 "_COMBO_2_WZ_RANGE" 433 "_COMBO_2_TEMP_RANGE" 434 "_CRC_FAIL_ROSF_CONFIG" 435 "_ROLL_SPI_MONITOR_FAULT" 436 "_CRC_FAIL_SAT_CONFIG" 437 "_SAT_SPI_PARITY_ERROR" 438 "_SAT_B_C_X_COMMUNICATION" 439 "_SAT_B_L_P_COMMUNICATION" 440 "_SAT_B_L_X_COMMUNICATION" 441 "_SAT_B_R_P_COMMUNICATION" 442 "_SAT_B_R_X_COMMUNICATION" 443 "_SAT_BP_L_X_COMMUNICATION" 444 "_SAT_BP_L_Y_COMMUNICATION" 445 "_SAT_BP_R_X_COMMUNICATION" 446 "_SAT_BP_R_Y_COMMUNICATION" 447 "_SAT_CP_L_Y_COMMUNICATION" 448 "_SAT_CP_R_Y_COMMUNICATION" 449 "_SAT_DO_L_P_COMMUNICATION" 450 "_SAT_DO_R_P_COMMUNICATION" 451 "_SAT_F_L_X_COMMUNICATION" 452 "_SAT_F_L_Y_COMMUNICATION" 453 "_SAT_F_R_X_COMMUNICATION" 454 "_SAT_F_R_Y_COMMUNICATION" 455 "_SAT_HV_C_X_COMMUNICATION" 456 "_SAT_HV_C_Y_COMMUNICATION" 457 "_SAT_B_C_X_CONFIG" 458 "_SAT_B_L_P_CONFIG" 459 "_SAT_B_L_X_CONFIG" 460 "_SAT_B_R_P_CONFIG" 461 "_SAT_B_R_X_CONFIG" 462 "_SAT_BP_L_X_CONFIG" 463 "_SAT_BP_L_Y_CONFIG" 464 "_SAT_BP_R_X_CONFIG" 465 "_SAT_BP_R_Y_CONFIG" 466 "_SAT_CP_L_Y_CONFIG" 467 "_SAT_CP_R_Y_CONFIG" 468 "_SAT_DO_L_P_CONFIG" 469 "_SAT_DO_R_P_CONFIG" 470 "_SAT_F_L_X_CONFIG" 471 "_SAT_F_L_Y_CONFIG" 472 "_SAT_F_R_X_CONFIG" 473 "_SAT_F_R_Y_CONFIG" 474 "_SAT_HV_C_X_CONFIG" 475 "_SAT_HV_C_Y_CONFIG" 476 "_SAT_B_C_X_CROSSLINK" 477 "_SAT_B_L_P_CROSSLINK" 478 "_SAT_B_L_X_CROSSLINK" 479 "_SAT_B_R_P_CROSSLINK" 480 "_SAT_B_R_X_CROSSLINK" 481 "_SAT_BP_L_X_CROSSLINK" 482 "_SAT_BP_L_Y_CROSSLINK" 483 "_SAT_BP_R_X_CROSSLINK" 484 "_SAT_BP_R_Y_CROSSLINK" 485 "_SAT_CP_L_Y_CROSSLINK" 486 "_SAT_CP_R_Y_CROSSLINK" 487 "_SAT_DO_L_P_CROSSLINK" 488 "_SAT_DO_R_P_CROSSLINK" 489 "_SAT_F_L_X_CROSSLINK" 490 "_SAT_F_L_Y_CROSSLINK" 491 "_SAT_F_R_X_CROSSLINK" 492 "_SAT_F_R_Y_CROSSLINK" 493 "_SAT_HV_C_X_CROSSLINK" 494 "_SAT_HV_C_Y_CROSSLINK" 495 "_SAT_B_C_X_LEAK_TO_GND" 496 "_SAT_B_L_P_LEAK_TO_GND" 497 "_SAT_B_L_X_LEAK_TO_GND" 498 "_SAT_B_R_P_LEAK_TO_GND" 499 "_SAT_B_R_X_LEAK_TO_GND" 500 "_SAT_BP_L_X_LEAK_TO_GND" 501 "_SAT_BP_L_Y_LEAK_TO_GND" 502 "_SAT_BP_R_X_LEAK_TO_GND" 503 "_SAT_BP_R_Y_LEAK_TO_GND" 504 "_SAT_CP_L_Y_LEAK_TO_GND" 505 "_SAT_CP_R_Y_LEAK_TO_GND" 506 "_SAT_DO_L_P_LEAK_TO_GND" 507 "_SAT_DO_R_P_LEAK_TO_GND" 508 "_SAT_F_L_X_LEAK_TO_GND" 509 "_SAT_F_L_Y_LEAK_TO_GND" 510 "_SAT_F_R_X_LEAK_TO_GND" 511 "_SAT_F_R_Y_LEAK_TO_GND" 512 "_SAT_HV_C_X_LEAK_TO_GND" 513 "_SAT_HV_C_Y_LEAK_TO_GND" 514 "_SAT_B_C_X_LEAK_TO_UBATT" 515 "_SAT_B_L_P_LEAK_TO_UBATT" 516 "_SAT_B_L_X_LEAK_TO_UBATT" 517 "_SAT_B_R_P_LEAK_TO_UBATT" 518 "_SAT_B_R_X_LEAK_TO_UBATT" 519 "_SAT_BP_L_X_LEAK_TO_UBATT" 520 "_SAT_BP_L_Y_LEAK_TO_UBATT" 521 "_SAT_BP_R_X_LEAK_TO_UBATT" 522 "_SAT_BP_R_Y_LEAK_TO_UBATT" 523 "_SAT_CP_L_Y_LEAK_TO_UBATT" 524 "_SAT_CP_R_Y_LEAK_TO_UBATT" 525 "_SAT_DO_L_P_LEAK_TO_UBATT" 526 "_SAT_DO_R_P_LEAK_TO_UBATT" 527 "_SAT_F_L_X_LEAK_TO_UBATT" 528 "_SAT_F_L_Y_LEAK_TO_UBATT" 529 "_SAT_F_R_X_LEAK_TO_UBATT" 530 "_SAT_F_R_Y_LEAK_TO_UBATT" 531 "_SAT_HV_C_X_LEAK_TO_UBATT" 532 "_SAT_HV_C_Y_LEAK_TO_UBATT" 533 "_SAT_B_C_X_NOK_SI" 534 "_SAT_B_L_P_NOK_SI" 535 "_SAT_B_L_X_NOK_SI" 536 "_SAT_B_R_P_NOK_SI" 537 "_SAT_B_R_X_NOK_SI" 538 "_SAT_BP_L_X_NOK_SI" 539 "_SAT_BP_L_Y_NOK_SI" 540 "_SAT_BP_R_X_NOK_SI" 541 "_SAT_BP_R_Y_NOK_SI" 542 "_SAT_CP_L_Y_NOK_SI" 543 "_SAT_CP_R_Y_NOK_SI" 544 "_SAT_DO_L_P_NOK_SI" 545 "_SAT_DO_R_P_NOK_SI" 546 "_SAT_F_L_X_NOK_SI" 547 "_SAT_F_L_Y_NOK_SI" 548 "_SAT_F_R_X_NOK_SI" 549 "_SAT_F_R_Y_NOK_SI" 550 "_SAT_HV_C_X_NOK_SI" 551 "_SAT_HV_C_Y_NOK_SI" 552 "_SAT_B_C_X_OPEN_LINE" 553 "_SAT_B_L_P_OPEN_LINE" 554 "_SAT_B_L_X_OPEN_LINE" 555 "_SAT_B_R_P_OPEN_LINE" 556 "_SAT_B_R_X_OPEN_LINE" 557 "_SAT_BP_L_X_OPEN_LINE" 558 "_SAT_BP_L_Y_OPEN_LINE" 559 "_SAT_BP_R_X_OPEN_LINE" 560 "_SAT_BP_R_Y_OPEN_LINE" 561 "_SAT_CP_L_Y_OPEN_LINE" 562 "_SAT_CP_R_Y_OPEN_LINE" 563 "_SAT_DO_L_P_OPEN_LINE" 564 "_SAT_DO_R_P_OPEN_LINE" 565 "_SAT_F_L_X_OPEN_LINE" 566 "_SAT_F_L_Y_OPEN_LINE" 567 "_SAT_F_R_X_OPEN_LINE" 568 "_SAT_F_R_Y_OPEN_LINE" 569 "_SAT_HV_C_X_OPEN_LINE" 570 "_SAT_HV_C_Y_OPEN_LINE" 571 "_SAT_B_C_X_PARAMETER" 572 "_SAT_B_L_P_PARAMETER" 573 "_SAT_B_L_X_PARAMETER" 574 "_SAT_B_R_P_PARAMETER" 575 "_SAT_B_R_X_PARAMETER" 576 "_SAT_BP_L_X_PARAMETER" 577 "_SAT_BP_L_Y_PARAMETER" 578 "_SAT_BP_R_X_PARAMETER" 579 "_SAT_BP_R_Y_PARAMETER" 580 "_SAT_CP_L_Y_PARAMETER" 581 "_SAT_CP_R_Y_PARAMETER" 582 "_SAT_DO_L_P_PARAMETER" 583 "_SAT_DO_R_P_PARAMETER" 584 "_SAT_F_L_X_PARAMETER" 585 "_SAT_F_L_Y_PARAMETER" 586 "_SAT_F_R_X_PARAMETER" 587 "_SAT_F_R_Y_PARAMETER" 588 "_SAT_HV_C_X_PARAMETER" 589 "_SAT_HV_C_Y_PARAMETER" 590 "_SAT_DO_L_P_PLAUSIBILITY" 591 "_SAT_DO_R_P_PLAUSIBILITY" 592 "_SAT_B_L_P_PLAUSIBILITY" 593 "_SAT_B_R_P_PLAUSIBILITY" 594 "_SAT_B_C_X_SENSOR_DEFECT" 595 "_SAT_B_L_P_SENSOR_DEFECT" 596 "_SAT_B_L_X_SENSOR_DEFECT" 597 "_SAT_B_R_P_SENSOR_DEFECT" 598 "_SAT_B_R_X_SENSOR_DEFECT" 599 "_SAT_BP_L_X_SENSOR_DEFECT" 600 "_SAT_BP_L_Y_SENSOR_DEFECT" 601 "_SAT_BP_R_X_SENSOR_DEFECT" 602 "_SAT_BP_R_Y_SENSOR_DEFECT" 603 "_SAT_CP_L_Y_SENSOR_DEFECT" 604 "_SAT_CP_R_Y_SENSOR_DEFECT" 605 "_SAT_DO_L_P_SENSOR_DEFECT" 606 "_SAT_DO_R_P_SENSOR_DEFECT" 607 "_SAT_F_L_X_SENSOR_DEFECT" 608 "_SAT_F_L_Y_SENSOR_DEFECT" 609 "_SAT_F_R_X_SENSOR_DEFECT" 610 "_SAT_F_R_Y_SENSOR_DEFECT" 611 "_SAT_HV_C_X_SENSOR_DEFECT" 612 "_SAT_HV_C_Y_SENSOR_DEFECT" 613 "_SAT_IF1_VSAT_ERROR" 614 "_SAT_IF2_VSAT_ERROR" 615 "_SAT_IF3_VSAT_ERROR" 616 "_SAT_IF4_VSAT_ERROR" 617 "_SAT_IF5_VSAT_ERROR" 618 "_SAT_IF6_VSAT_ERROR" 619 "_SAT_IF7_VSAT_ERROR" 620 "_SAT_IF8_VSAT_ERROR" 621 "_SAT_IF9_VSAT_ERROR" 622 "_SAT_IF10_VSAT_ERROR" 623 "_SAT_IF11_VSAT_ERROR" 624 "_SAT_IF12_VSAT_ERROR" 625 "_SAT_IF13_VSAT_ERROR" 626 "_SAT_IF14_VSAT_ERROR" 627 "_SAT_IF15_VSAT_ERROR" 628 "_SAT_IF16_VSAT_ERROR" 629 "_ALGO_ISA_EEPROM_CRC_FAIL" 630 "_ALGO_MODAR_EEPROM_CRC_FAIL" 631 "_SIGNAL_FAULT_CHANNEL_X" 632 "_SIGNAL_FAULT_CHANNEL_Y" 633 "_SIGNAL_FAULT_CHANNEL_R" 634 "_SIGNAL_FAULT_CHANNEL_XQ" 635 "_SIGNAL_FAULT_CHANNEL_YQ" 636 "_SIGNAL_FAULT_CHANNEL_P" 637 "_SIGNAL_FAULT_CHANNEL_YLOW" 638 "_SIGNAL_FAULT_CHANNEL_Z" 639 "_MISMATCH_LAYOUT_EOL_MODAR_SWV" 640 "_MISMATCH_LAYOUT_EOL_ISA_SWV" 641 "_INVALID_SW_CONF_OF_SENSORS" 642 "_MODAR_DATAPREP" 643 "_ALGO_DATAPREP" 644 "_MODAR_DATAPREP_RAM_BUF_FULL" 645 "_ADC_CYCLIC_TEST" 646 "_RAM_CRC_FAIL" 647 "_PORT_SHORT_LSENQ" 648 "_NVM_FAILURE" 649 "_DETERRORHOOK" 650 "_MPU_EXCEPTION" 651 "_EXCEPTION" 652 "_STACK_OVER_THRESHOLD" 653 "_RESET" 654 "_UNCONFIRMED_ACTIVATION_ARM_OMNI" 655 "_UNCONFIRMED_ACTIVATION_ARM_FRONT" 656 "_DTC_0x900639_FH" 657 "_PAAL_LEAK_TO_GND" 658 "_LD1_PIN_OPEN" 659 "_DTC_0x900394_FH" 660 "_ASICS_M720_CRC_FAIL" 661 "_PCB_M720_CRC_FAIL" 662 "_ROM_CRC_FAIL" 663 "_DTC_0x900259_FH" 664 "_BS3L_LEAK_TO_GND" 665 "_BS3L_SHORT" 666 "_DTC_0x900354_FH" 2048 "ST_COMPLETED_AWL_ON" 2049 "ST_COMPLETED" 2050 "ST_PHASE2A" 2051 "ST_PHASE2B" 2052 "ST_PHASE3A" 2053 "ST_PHASE3B" 2054 "ST_PHASE3C" 2055 "ST_PHASE3D" 2056 "ST_PHASE3E" 2057 "ST_PHASE4E" 2058 "ST_COMPLETED_DL_MEASUREMENTS_DISABLED" 2064 "ARM_FRONT_START" 2065 "ARM_FRONT_RESET" 2066 "ARM_OMNI_START" 2067 "ARM_OMNI_RESET" 2068 "ARM_PPS_START" 2069 "ARM_PPS_RESET" 2070 "ARM_SENS_START" 2071 "ARM_SENS_RESET" 2072 "ARM_LOWRISK_START" 2073 "ARM_LOWRISK_RESET" 2074 "ARM_AOS_START" 2075 "ARM_AOS_RESET" 2076 "ARM_CUSTOMER_SPECIFIC_START" 2077 "ARM_CUSTOMER_SPECIFIC_RESET" 2080 "SUPPLY_LOSS_OF_BATTEY" 2081 "COM_SUPPLY_UNDER_VOLTAGE" 2082 "COM_SUPPLY_OVER_VOLTAGE" 2096 "SIDE_ALGO_STARTED" 2097 "SIDE_ALGO_RESET" 2098 "FRONT_ALGO_STARTED" 2099 "FRONT_ALGO_RESET" 2100 "REAR_ALGO_STARTED" 2101 "REAR_ALGO_RESET" 2102 "ROLLOVER_ALGO_STARTED" 2103 "ROLLOVER_ALGO_RESET" 2104 "PITCHOVER_ALGO_STARTED" 2105 "PITCHOVER_ALGO_RESET" 2106 "PPS_ALGO_STARTED" 2107 "PPS_ALGO_RESET" 2128 "PSI5_1_STATE_CHANGE" 2129 "PSI5_2_STATE_CHANGE" 2130 "PSI5_3_STATE_CHANGE" 2131 "PSI5_4_STATE_CHANGE" 2132 "PSI5_5_STATE_CHANGE" 2133 "PSI5_6_STATE_CHANGE" 2134 "PSI5_7_STATE_CHANGE" 2135 "PSI5_8_STATE_CHANGE" 2136 "PSI5_9_STATE_CHANGE" 2137 "PSI5_10_STATE_CHANGE" 2138 "PSI5_11_STATE_CHANGE" 2139 "PSI5_12_STATE_CHANGE" 2140 "PSI5_13_STATE_CHANGE" 2141 "PSI5_14_STATE_CHANGE" 2142 "PSI5_15_STATE_CHANGE" 2143 "PSI5_16_STATE_CHANGE" 2144 "SAT1_INVALID_DATA" 2145 "SAT2_INVALID_DATA" 2146 "SAT3_INVALID_DATA" 2147 "SAT4_INVALID_DATA" 2148 "SAT5_INVALID_DATA" 2149 "SAT6_INVALID_DATA" 2150 "SAT7_INVALID_DATA" 2151 "SAT8_INVALID_DATA" 2152 "SAT9_INVALID_DATA" 2153 "SAT10_INVALID_DATA" 2154 "SAT11_INVALID_DATA" 2155 "SAT12_INVALID_DATA" 2156 "SAT13_INVALID_DATA" 2157 "SAT14_INVALID_DATA" 2158 "SAT15_INVALID_DATA" 2159 "SAT16_INVALID_DATA" 2176 "ASG1_X_STATE_CHANGE" 2177 "ASG1_Y_STATE_CHANGE" 2178 "ASG2_X_STATE_CHANGE" 2179 "ASG2_Y_STATE_CHANGE" 2180 "COMBO_LOW_g_X_STATE_CHANGE" 2181 "COMBO_LOW_g_Y_STATE_CHANGE" 2182 "COMBO_LOW_g_Z_STATE_CHANGE" 2183 "COMBO_ROLL_STATE_CHANGE" 2184 "COMBO_YAW_STATE_CHANGE" 2185 "COMBO2_X_STATE_CHANGE" 2186 "COMBO2_Y_STATE_CHANGE" 2187 "COMBO2_Z_STATE_CHANGE" 2188 "COMBO2_ROLL_STATE_CHANGE" 2189 "COMBO2_YAW_STATE_CHANGE" 2190 "COMBO3_X_STATE_CHANGE" 2191 "COMBO3_Y_STATE_CHANGE" 2192 "COMBO3_Z_STATE_CHANGE" 2193 "COMBO3_ROLL_STATE_CHANGE" 2194 "COMBO3_YAW_STATE_CHANGE" DEFAULT_VALUE "" /end COMPU_VTAB
/begin COMPU_VTAB_RANGE OCA_e_ShutdownStepQm.CONVERSION "@@@@RuleName created by CANape" 5 0 0 "OCA_e_IDLE" 1 1 "OCA_e_SHUTDOWN_REQUESTED" 2 2 "OCA_e_OPTIME_WRITE_ONGOING" 3 3 "OCA_e_NVM_WRITEALL_ONGOING" 4 4 "OCA_e_NVM_WRITEALL_FINISHED" DEFAULT_VALUE "" /end COMPU_VTAB_RANGE
/begin COMPU_VTAB_RANGE OCA_e_ShutdownStepQm.CONVERSION "@@@@RuleName created by CANape" 5 0 0 "OCA_e_IDLE" 1 1 "OCA_e_SHUTDOWN_REQUESTED" 2 2 "OCA_e_OPTIME_WRITE_ONGOING" 3 3 "OCA_e_NVM_WRITEALL_ONGOING" 4 4 "OCA_e_NVM_WRITEALL_FINISHED" DEFAULT_VALUE "" /end COMPU_VTAB_RANGE
/begin COMPU_VTAB_RANGE OCA_e_ShutdownStepQm.CONVERSION "@@@@RuleName created by CANape" 5 0 0 "OCA_e_IDLE" 1 1 "OCA_e_SHUTDOWN_REQUESTED" 2 2 "OCA_e_OPTIME_WRITE_ONGOING" 3 3 "OCA_e_NVM_WRITEALL_ONGOING" 4 4 "OCA_e_NVM_WRITEALL_FINISHED" DEFAULT_VALUE "" /end COMPU_VTAB_RANGE
/begin COMPU_VTAB_RANGE OCA_e_ShutdownStepQm.CONVERSION "@@@@RuleName created by CANape" 5 0 0 "OCA_e_IDLE" 1 1 "OCA_e_SHUTDOWN_REQUESTED" 2 2 "OCA_e_OPTIME_WRITE_ONGOING" 3 3 "OCA_e_NVM_WRITEALL_ONGOING" 4 4 "OCA_e_NVM_WRITEALL_FINISHED" DEFAULT_VALUE "" /end COMPU_VTAB_RANGE
/begin COMPU_VTAB_RANGE OCA_e_ShutdownStepQm.CONVERSION "@@@@RuleName created by CANape" 5 0 0 "OCA_e_IDLE" 1 1 "OCA_e_SHUTDOWN_REQUESTED" 2 2 "OCA_e_OPTIME_WRITE_ONGOING" 3 3 "OCA_e_NVM_WRITEALL_ONGOING" 4 4 "OCA_e_NVM_WRITEALL_FINISHED" DEFAULT_VALUE "" /end COMPU_VTAB_RANGE
/begin COMPU_VTAB_RANGE OCA_e_ShutdownStepQm.CONVERSION "@@@@RuleName created by CANape" 5 0 0 "OCA_e_IDLE" 1 1 "OCA_e_SHUTDOWN_REQUESTED" 2 2 "OCA_e_OPTIME_WRITE_ONGOING" 3 3 "OCA_e_NVM_WRITEALL_ONGOING" 4 4 "OCA_e_NVM_WRITEALL_FINISHED" DEFAULT_VALUE "" /end COMPU_VTAB_RANGE
/begin COMPU_VTAB REF_SQUIB_LEAKAGE "interpretation table for the reference squib resistor leakage." TAB_VERB 8 0 "RES_TO_HIGH" 1 "RES_TO_HIGH" 2 "RES_TO_HIGH" 3 "OK" 4 "LEAK_BAT" 5 "LEAK_BAT" 6 "LEAK_BAT" 7 "LEAK_BAT" DEFAULT_VALUE "" /end COMPU_VTAB
/begin COMPU_VTAB SATLine_as_LineInfo._9_.e_StateTask.CONVERSION "enumeration table" TAB_VERB 6 0 "SATType_e_LINE_STOPPED" 1 "SATType_e_LINE_STARTED" 2 "SATType_e_NORMAL_OPERATION" 3 "SATType_e_NOT_POPULATED" 4 "SATType_e_NOT_POPULATED_UNEXPECTED_TEST" 5 "SATType_e_NOT_SUPPORTED" DEFAULT_VALUE "" /end COMPU_VTAB
/begin COMPU_VTAB SATSen_as_Sensor._9_.e_SenState.CONVERSION "enumeration table" TAB_VERB 6 0 "SATType_e_SENSOR_STOPPED" 1 "SATType_e_ID_PHASE" 2 "SATType_e_ID_OPTIONAL_PHASE2B" 3 "SATType_e_SENSOR_TEST_PHASE" 4 "SATType_e_WAIT_RELEASE" 5 "SATType_e_CYCLIC_PHASE" DEFAULT_VALUE "" /end COMPU_VTAB
/begin COMPU_VTAB_RANGE SAT_1_STATE.CONVERSION "" 7 0 0 "SATType_e_SENSOR_STOPPED" 1 1 "SATType_e_OSCILLATOR_PHASE" 2 2 "SATType_e_ID_PHASE" 3 3 "SATType_e_ID_OPTIONAL_PHASE2B" 4 4 "SATType_e_SENSOR_TEST_PHASE" 5 5 "SATType_e_WAIT_RELEASE" 6 6 "SATType_e_CYCLIC_PHASE" DEFAULT_VALUE "" /end COMPU_VTAB_RANGE
/begin COMPU_VTAB_RANGE SAT_1_STATE.CONVERSION.OLD_1 "" 6 0 0 "SATType_e_SENSOR_STOPPED" 1 1 "SATType_e_ID_PHASE" 2 2 "SATType_e_ID_OPTIONAL_PHASE2B" 3 3 "SATType_e_SENSOR_TEST_PHASE" 4 4 "SATType_e_WAIT_RELEASE" 5 5 "SATType_e_CYCLIC_PHASE" DEFAULT_VALUE "" /end COMPU_VTAB_RANGE
/begin COMPU_VTAB SAT_LINE_STATE "enumeration table" TAB_VERB 6 0 "LINE_STOPPED" 1 "LINE_STARTED" 2 "NORMAL_OPERATION" 3 "NOT_POPULATED" 4 "NOT_POPULATED_UNEXPECTED_TEST" 5 "NOT_SUPPORTED" DEFAULT_VALUE "" /end COMPU_VTAB
/begin COMPU_VTAB_RANGE SAT_Line_1_State.CONVERSION "" 6 0 0 "SATType_e_LINE_STOPPED" 1 1 "SATType_e_LINE_STARTED" 2 2 "SATType_e_NORMAL_OPERATION" 3 3 "SATType_e_NOT_POPULATED" 4 4 "SATType_e_NOT_POPULATED_UNEXPECTED_TEST" 5 5 "SATType_e_NOT_SUPPORTED" DEFAULT_VALUE "" /end COMPU_VTAB_RANGE
/begin COMPU_VTAB_RANGE SEN_STATE "" 6 0 0 "SATType_e_SENSOR_STOPPED" 1 1 "SATType_e_ID_PHASE" 2 2 "SATType_e_ID_OPTIONAL_PHASE2B" 3 3 "SATType_e_SENSOR_TEST_PHASE" 4 4 "SATType_e_WAIT_NORMAL_DATA" 5 5 "SATType_e_CYCLIC_PHASE" DEFAULT_VALUE "" /end COMPU_VTAB_RANGE
/begin COMPU_VTAB SWIHIF_REF_MEAS_STATUS "status of the SWIHIF refference measurement status provided by HAL" TAB_VERB 3 0 "MEAS_NOT_PERFORMED" 1 "MEAS_NOT_OK" 2 "MEAS_OK" DEFAULT_VALUE "" /end COMPU_VTAB
/begin COMPU_TAB SWIHIF_REF_MEAS_STATUS2 "" TAB_NOINTP 0 /end COMPU_TAB
/begin COMPU_VTAB SWIHIF_REF_STATUS "Reference measurement status for SWIHIF." TAB_VERB 3 0 "MEAS_NOT_PERFORMED" 1 "MEAS_NOT_OK" 2 "MEAS_OK" DEFAULT_VALUE "" /end COMPU_VTAB
/begin COMPU_VTAB SWIHIF_STATUS "status of the SWIHIF interface provided by HAL" TAB_VERB 7 1 "Invalid Configuration" 2 "Measurement not available" 4 "Leakage to VBAT" 8 "Leakage to GND" 16 "Open" 32 "Short" 64 "OK" DEFAULT_VALUE "" /end COMPU_VTAB
/begin COMPU_VTAB SWIHIF_TYPES "Types of switches measured by SWIHIF" TAB_VERB 8 0 "RCwRL_M1" 1 "RC_M1" 2 "HALL" 3 "HALLwRL" 4 "MIC_RC" 5 "RC_AOS" 6 "RCwMUXwADC" 7 "VC_M1" DEFAULT_VALUE "" /end COMPU_VTAB
/begin COMPU_VTAB SWITCH_STATE "Decoding table for switch state" TAB_VERB 16 0 "STATE_NOT_AVAILABLE" 1 "STATE_1" 2 "STATE_2" 3 "STATE_3" 4 "STATE_4" 5 "STATE_5" 6 "NOT_CONFIGURED" 7 "NOT_PRESENT" 8 "FAULT" 9 "INVALID_RANGE" 10 "OPEN" 11 "SHORT" 12 "LEAK_BAT" 13 "LEAK_GND" 14 "INVALID_CFG" 15 "CROSSLINK" DEFAULT_VALUE "" /end COMPU_VTAB
/begin COMPU_VTAB SWITCH_STATE_CROSSLINK "Decoding table for switch crosslink state" TAB_VERB 4 0 "NO_CROSLINK_DETECTED" 1 "CROSSLINK_DETECTED" 2 "CROSSLINK_SKIP" 3 "CROSSLINK_NOT_CONFIGURED" DEFAULT_VALUE "" /end COMPU_VTAB
/begin COMPU_VTAB_RANGE YES_NO "" 2 0 0 "NO" 1 255 "YES" DEFAULT_VALUE "" /end COMPU_VTAB_RANGE
/begin COMPU_VTAB_RANGE _STT_PH_e_Phase.CONVERSION "@@@@RuleName created by CANape" 9 0 0 "STTStartupPhases_e_PHASE_INIT" 42 42 "STTStartupPhases_e_PHASE_2A" 43 43 "STTStartupPhases_e_PHASE_2B" 58 58 "STTStartupPhases_e_PHASE_3A" 59 59 "STTStartupPhases_e_PHASE_3B" 60 60 "STTStartupPhases_e_PHASE_3C" 61 61 "STTStartupPhases_e_PHASE_3D" 64 64 "STTStartupPhases_e_PHASE_4" 78 78 "STTStartupPhases_e_PHASE_4E" DEFAULT_VALUE "" /end COMPU_VTAB_RANGE
/begin RECORD_LAYOUT SSV__A_INT64_S AXIS_PTS_X 1 A_INT64 INDEX_INCR DIRECT /end RECORD_LAYOUT
/begin RECORD_LAYOUT SSV__A_UINT64_S AXIS_PTS_X 1 A_UINT64 INDEX_INCR DIRECT /end RECORD_LAYOUT
/begin RECORD_LAYOUT SSV__FLOAT32_IEEE_S AXIS_PTS_X 1 FLOAT32_IEEE INDEX_INCR DIRECT /end RECORD_LAYOUT
/begin RECORD_LAYOUT SSV__FLOAT64_IEEE_S AXIS_PTS_X 1 FLOAT64_IEEE INDEX_INCR DIRECT /end RECORD_LAYOUT
/begin RECORD_LAYOUT SSV__SBYTE_S AXIS_PTS_X 1 SBYTE INDEX_INCR DIRECT /end RECORD_LAYOUT
/begin RECORD_LAYOUT SSV__SLONG_S AXIS_PTS_X 1 SLONG INDEX_INCR DIRECT /end RECORD_LAYOUT
/begin RECORD_LAYOUT SSV__SWORD_S AXIS_PTS_X 1 SWORD INDEX_INCR DIRECT /end RECORD_LAYOUT
/begin RECORD_LAYOUT SSV__UBYTE_S AXIS_PTS_X 1 UBYTE INDEX_INCR DIRECT /end RECORD_LAYOUT
/begin RECORD_LAYOUT SSV__ULONG_S AXIS_PTS_X 1 ULONG INDEX_INCR DIRECT /end RECORD_LAYOUT
/begin RECORD_LAYOUT SSV__UWORD_S AXIS_PTS_X 1 UWORD INDEX_INCR DIRECT /end RECORD_LAYOUT
/begin RECORD_LAYOUT UXCP_t_DvmCode.Layout FNC_VALUES 1 UWORD COLUMN_DIR DIRECT /end RECORD_LAYOUT
/begin RECORD_LAYOUT __A_INT64_S FNC_VALUES 1 A_INT64 COLUMN_DIR DIRECT /end RECORD_LAYOUT
/begin RECORD_LAYOUT __A_INT64_Z FNC_VALUES 1 A_INT64 ROW_DIR DIRECT /end RECORD_LAYOUT
/begin RECORD_LAYOUT __A_UINT64_S FNC_VALUES 1 A_UINT64 COLUMN_DIR DIRECT /end RECORD_LAYOUT
/begin RECORD_LAYOUT __A_UINT64_Z FNC_VALUES 1 A_UINT64 ROW_DIR DIRECT /end RECORD_LAYOUT
/begin RECORD_LAYOUT __FLOAT32_IEEE_S FNC_VALUES 1 FLOAT32_IEEE COLUMN_DIR DIRECT /end RECORD_LAYOUT
/begin RECORD_LAYOUT __FLOAT32_IEEE_Z FNC_VALUES 1 FLOAT32_IEEE ROW_DIR DIRECT /end RECORD_LAYOUT
/begin RECORD_LAYOUT __FLOAT64_IEEE_S FNC_VALUES 1 FLOAT64_IEEE COLUMN_DIR DIRECT /end RECORD_LAYOUT
/begin RECORD_LAYOUT __FLOAT64_IEEE_Z FNC_VALUES 1 FLOAT64_IEEE ROW_DIR DIRECT /end RECORD_LAYOUT
/begin RECORD_LAYOUT __Float32_Value FNC_VALUES 1 FLOAT32_IEEE ROW_DIR DIRECT /end RECORD_LAYOUT
/begin RECORD_LAYOUT __SBYTE_S FNC_VALUES 1 SBYTE COLUMN_DIR DIRECT /end RECORD_LAYOUT
/begin RECORD_LAYOUT __SBYTE_Z FNC_VALUES 1 SBYTE ROW_DIR DIRECT /end RECORD_LAYOUT
/begin RECORD_LAYOUT __SByte_Value FNC_VALUES 1 SBYTE ROW_DIR DIRECT /end RECORD_LAYOUT
/begin RECORD_LAYOUT __SLONG_S FNC_VALUES 1 SLONG COLUMN_DIR DIRECT /end RECORD_LAYOUT
/begin RECORD_LAYOUT __SLONG_Z FNC_VALUES 1 SLONG ROW_DIR DIRECT /end RECORD_LAYOUT
/begin RECORD_LAYOUT __SWORD_S FNC_VALUES 1 SWORD COLUMN_DIR DIRECT /end RECORD_LAYOUT
/begin RECORD_LAYOUT __SWORD_Z FNC_VALUES 1 SWORD ROW_DIR DIRECT /end RECORD_LAYOUT
/begin RECORD_LAYOUT __UBYTE_S FNC_VALUES 1 UBYTE COLUMN_DIR DIRECT /end RECORD_LAYOUT
/begin RECORD_LAYOUT __UBYTE_Z FNC_VALUES 1 UBYTE ROW_DIR DIRECT /end RECORD_LAYOUT
/begin RECORD_LAYOUT __UByte_Value FNC_VALUES 1 UBYTE ROW_DIR DIRECT /end RECORD_LAYOUT
/begin RECORD_LAYOUT __ULONG_S FNC_VALUES 1 ULONG COLUMN_DIR DIRECT /end RECORD_LAYOUT
/begin RECORD_LAYOUT __ULONG_Z FNC_VALUES 1 ULONG ROW_DIR DIRECT /end RECORD_LAYOUT
/begin RECORD_LAYOUT __UWORD_S FNC_VALUES 1 UWORD COLUMN_DIR DIRECT /end RECORD_LAYOUT
/begin RECORD_LAYOUT __UWORD_Z FNC_VALUES 1 UWORD ROW_DIR DIRECT /end RECORD_LAYOUT
/begin GROUP NewGroup "" /begin REF_CHARACTERISTIC CD_Calibration /end REF_CHARACTERISTIC
 /begin REF_MEASUREMENT FlipState adc_xVal adc_yVal adc_zVal counter10ms g_results x_AxisG x_AxisResult y_AxisG y_AxisResult z_AxisG z_AxisResult /end REF_MEASUREMENT
/end GROUP
/end MODULE
/end PROJECT
