VERSION ""

NS_ :

BS_:

BU_:

BO_ 0 Test_Msg: 1 Vector__XXX
 SG_ Test_Sig : 0|8@1- (1,0) [0|0] "" Vector__XXX

BA_DEF_  "BusType" STRING ;
BA_DEF_DEF_  "BusType" "";
BA_ "BusType" "CAN";
